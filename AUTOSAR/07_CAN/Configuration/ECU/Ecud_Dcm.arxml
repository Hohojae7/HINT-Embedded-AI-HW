AUTOSAR XML (schema 4-0-3)
package /AUTOSAR
  module config Dcm: implementation-config-variant=VARIANT-PRE-COMPILE, module-description=BswImplementation_Dcm
    DcmConfigSet
      DcmDsd
        ES95486_SERVICE (DcmDsdServiceTable): DcmDsdSidTabId=0
          16 x DcmDsdService:
            SID10_DiagnosticSessionControl: DcmDsdSidTabServiceId=0x10, DcmDsdSidTabSubfuncAvail=1, DcmDsdSidTabSessionLevelRef=DCM_ALL_SESSION_LEVEL
              8 x DcmDsdSubService:
                defaultSession: DcmDsdSubServiceId=0x01
                programmingSession: DcmDsdSubServiceId=0x02, DcmDsdSubServiceSessionLevelRef=DCM_DEFAULT_SESSION, DcmDsdSubServiceSessionLevelRef=DCM_PROGRAMMING_SESSION, DcmDsdSubServiceSessionLevelRef=DCM_EXTENDED_DIAGNOSTIC_SESSION, DcmDsdSubServiceSessionLevelRef=DCM_ECU_PROGRAMMING_MODE, DcmDsdSubServiceSessionLevelRef=DCM_EXTENDED_DIAGNOSTIC_MODE
                extendedDiagnosticSession: DcmDsdSubServiceId=0x03, DcmDsdSubServiceSessionLevelRef=DCM_DEFAULT_SESSION, DcmDsdSubServiceSessionLevelRef=DCM_EXTENDED_DIAGNOSTIC_SESSION, DcmDsdSubServiceSessionLevelRef=DCM_SAFETY_SYSTEM_DIAGNOSTIC_SESSION, DcmDsdSubServiceSessionLevelRef=DCM_EXTENDED_DIAGNOSTIC_MODE
                safetySystemDiagnosticSession: DcmDsdSubServiceId=0x04, DcmDsdSubServiceSessionLevelRef=DCM_DEFAULT_SESSION, DcmDsdSubServiceSessionLevelRef=DCM_EXTENDED_DIAGNOSTIC_SESSION, DcmDsdSubServiceSessionLevelRef=DCM_SAFETY_SYSTEM_DIAGNOSTIC_SESSION, DcmDsdSubServiceSessionLevelRef=DCM_EXTENDED_DIAGNOSTIC_MODE
                ecuProgrammingMode: DcmDsdSubServiceId=0x05, DcmDsdSubServiceSessionLevelRef=DCM_DEFAULT_SESSION, DcmDsdSubServiceSessionLevelRef=DCM_PROGRAMMING_SESSION, DcmDsdSubServiceSessionLevelRef=DCM_EXTENDED_DIAGNOSTIC_SESSION, DcmDsdSubServiceSessionLevelRef=DCM_ECU_PROGRAMMING_MODE, DcmDsdSubServiceSessionLevelRef=DCM_EXTENDED_DIAGNOSTIC_MODE
                extendedDiagnosticMode: DcmDsdSubServiceId=0x10, DcmDsdSubServiceSessionLevelRef=DCM_DEFAULT_SESSION, DcmDsdSubServiceSessionLevelRef=DCM_EXTENDED_DIAGNOSTIC_SESSION, DcmDsdSubServiceSessionLevelRef=DCM_SAFETY_SYSTEM_DIAGNOSTIC_SESSION, DcmDsdSubServiceSessionLevelRef=DCM_EXTENDED_DIAGNOSTIC_MODE
                quiescent_current_diagnostic_mode: DcmDsdSubServiceId=0x50, DcmDsdSubServiceSessionLevelRef=DCM_DEFAULT_SESSION
                sleep_mode_start_request: DcmDsdSubServiceId=0x51
            SID11_ECUReset: DcmDsdSidTabServiceId=0x11, DcmDsdSidTabSubfuncAvail=1, DcmDsdSidTabSessionLevelRef=DCM_DEFAULT_SESSION, DcmDsdSidTabSessionLevelRef=DCM_PROGRAMMING_SESSION, DcmDsdSidTabSessionLevelRef=DCM_ECU_PROGRAMMING_MODE, DcmDsdSidTabSessionLevelRef=DCM_EXTENDED_DIAGNOSTIC_SESSION, DcmDsdSidTabSessionLevelRef=DCM_EXTENDED_DIAGNOSTIC_MODE, DcmDsdSidTabSessionLevelRef=DCM_SAFETY_SYSTEM_DIAGNOSTIC_SESSION
              5 x DcmDsdSubService:
                hardReset: DcmDsdSubServiceId=0x01
                keyOffOnReset: DcmDsdSubServiceId=0x02
                softReset: DcmDsdSubServiceId=0x03
                enableRapidPowerShutDown: DcmDsdSubServiceId=0x04
                disableRapidPowerShutDown: DcmDsdSubServiceId=0x05
            SID27_SecurityAccess: DcmDsdSidTabServiceId=0x27, DcmDsdSidTabSubfuncAvail=1, DcmDsdSidTabSessionLevelRef=DCM_PROGRAMMING_SESSION, DcmDsdSidTabSessionLevelRef=DCM_ECU_PROGRAMMING_MODE, DcmDsdSidTabSessionLevelRef=DCM_EXTENDED_DIAGNOSTIC_SESSION, DcmDsdSidTabSessionLevelRef=DCM_EXTENDED_DIAGNOSTIC_MODE, DcmDsdSidTabSessionLevelRef=DCM_SAFETY_SYSTEM_DIAGNOSTIC_SESSION
              6 x DcmDsdSubService:
                GetSeed: DcmDsdSubServiceId=0x01
                CompareKey: DcmDsdSubServiceId=0x02
                GetSeed_HSAC: DcmDsdSubServiceId=0x11
                CompareKey_HSAC: DcmDsdSubServiceId=0x12
                GetSeed_CSAC: DcmDsdSubServiceId=0x41
                CompareKey_CSAC: DcmDsdSubServiceId=0x42
            SID28_CommunicationControl: DcmDsdSidTabServiceId=0x28, DcmDsdSidTabSubfuncAvail=1, DcmDsdSidTabSessionLevelRef=DCM_PROGRAMMING_SESSION, DcmDsdSidTabSessionLevelRef=DCM_ECU_PROGRAMMING_MODE, DcmDsdSidTabSessionLevelRef=DCM_EXTENDED_DIAGNOSTIC_SESSION, DcmDsdSidTabSessionLevelRef=DCM_EXTENDED_DIAGNOSTIC_MODE
              4 x DcmDsdSubService:
                enableRxAndTx: DcmDsdSubServiceId=0
                disableNormalMessageTransmission: DcmDsdSubServiceId=1
                disableRxAndEnableTx: DcmDsdSubServiceId=2
                disableRxAndTx: DcmDsdSubServiceId=3
            SID29_EnableNormalMsgTransmission: DcmDsdSidTabServiceId=0x29, DcmDsdSidTabSubfuncAvail=1, DcmDsdSidTabSessionLevelRef=DCM_PROGRAMMING_SESSION, DcmDsdSidTabSessionLevelRef=DCM_ECU_PROGRAMMING_MODE, DcmDsdSidTabSessionLevelRef=DCM_EXTENDED_DIAGNOSTIC_SESSION, DcmDsdSidTabSessionLevelRef=DCM_EXTENDED_DIAGNOSTIC_MODE
              responseRequired (DcmDsdSubService): DcmDsdSubServiceId=0x01
              noResponseRequired (DcmDsdSubService): DcmDsdSubServiceId=0x02
            SID3E_TesterPresent: DcmDsdSidTabServiceId=0x3E, DcmDsdSidTabSubfuncAvail=1, DcmDsdSidTabSessionLevelRef=DCM_DEFAULT_SESSION, DcmDsdSidTabSessionLevelRef=DCM_PROGRAMMING_SESSION, DcmDsdSidTabSessionLevelRef=DCM_ECU_PROGRAMMING_MODE, DcmDsdSidTabSessionLevelRef=DCM_EXTENDED_DIAGNOSTIC_SESSION, DcmDsdSidTabSessionLevelRef=DCM_EXTENDED_DIAGNOSTIC_MODE, DcmDsdSidTabSessionLevelRef=DCM_SAFETY_SYSTEM_DIAGNOSTIC_SESSION
              zeroSubFunction (DcmDsdSubService): DcmDsdSubServiceId=0x0
            SID85_ControlDTCSetting: DcmDsdSidTabServiceId=0x85, DcmDsdSidTabSubfuncAvail=1, DcmDsdSidTabSessionLevelRef=DCM_PROGRAMMING_SESSION, DcmDsdSidTabSessionLevelRef=DCM_ECU_PROGRAMMING_MODE, DcmDsdSidTabSessionLevelRef=DCM_EXTENDED_DIAGNOSTIC_SESSION, DcmDsdSidTabSessionLevelRef=DCM_EXTENDED_DIAGNOSTIC_MODE
              On (DcmDsdSubService): DcmDsdSubServiceId=0x01
              Off (DcmDsdSubService): DcmDsdSubServiceId=0x02
            SID20_StopDiagnosticSession: DcmDsdSidTabServiceId=0x20, DcmDsdSidTabSubfuncAvail=0, DcmDsdSidTabSessionLevelRef=DCM_DEFAULT_SESSION, DcmDsdSidTabSessionLevelRef=DCM_PROGRAMMING_SESSION, DcmDsdSidTabSessionLevelRef=DCM_ECU_PROGRAMMING_MODE, DcmDsdSidTabSessionLevelRef=DCM_EXTENDED_DIAGNOSTIC_SESSION, DcmDsdSidTabSessionLevelRef=DCM_EXTENDED_DIAGNOSTIC_MODE
            SID22_ReadDataByIdentifier: DcmDsdSidTabServiceId=0x22, DcmDsdSidTabSubfuncAvail=0, DcmDsdSidTabSessionLevelRef=DCM_DEFAULT_SESSION, DcmDsdSidTabSessionLevelRef=DCM_EXTENDED_DIAGNOSTIC_SESSION, DcmDsdSidTabSessionLevelRef=DCM_EXTENDED_DIAGNOSTIC_MODE, DcmDsdSidTabSessionLevelRef=DCM_SAFETY_SYSTEM_DIAGNOSTIC_SESSION, DcmDsdSidTabSessionLevelRef=DCM_QUIESCENT_CURRENT_DIAGNOSTIC_MODE
            SID23_ReadMemoryByAddress: DcmDsdSidTabServiceId=0x23, DcmDsdSidTabSubfuncAvail=0, DcmDsdSidTabSessionLevelRef=DCM_DEFAULT_SESSION, DcmDsdSidTabSessionLevelRef=DCM_EXTENDED_DIAGNOSTIC_SESSION, DcmDsdSidTabSessionLevelRef=DCM_EXTENDED_DIAGNOSTIC_MODE
            SID2E_WriteDataByIdentifier: DcmDsdSidTabServiceId=0x2E, DcmDsdSidTabSubfuncAvail=0, DcmDsdSidTabSecurityLevelRef=L1, DcmDsdSidTabSessionLevelRef=DCM_DEFAULT_SESSION, DcmDsdSidTabSessionLevelRef=DCM_PROGRAMMING_SESSION, DcmDsdSidTabSessionLevelRef=DCM_ECU_PROGRAMMING_MODE, DcmDsdSidTabSessionLevelRef=DCM_EXTENDED_DIAGNOSTIC_SESSION, DcmDsdSidTabSessionLevelRef=DCM_EXTENDED_DIAGNOSTIC_MODE, DcmDsdSidTabSessionLevelRef=DCM_SAFETY_SYSTEM_DIAGNOSTIC_SESSION
            SID3D_WriteMemoryByAddress: DcmDsdSidTabServiceId=0x3D, DcmDsdSidTabSubfuncAvail=0, DcmDsdSidTabSecurityLevelRef=L1, DcmDsdSidTabSessionLevelRef=DCM_DEFAULT_SESSION, DcmDsdSidTabSessionLevelRef=DCM_PROGRAMMING_SESSION, DcmDsdSidTabSessionLevelRef=DCM_ECU_PROGRAMMING_MODE, DcmDsdSidTabSessionLevelRef=DCM_EXTENDED_DIAGNOSTIC_SESSION, DcmDsdSidTabSessionLevelRef=DCM_EXTENDED_DIAGNOSTIC_MODE
            SID19_ReadDTCInformation: DcmDsdSidTabServiceId=0x19, DcmDsdSidTabSubfuncAvail=1, DcmDsdSidTabSessionLevelRef=DCM_DEFAULT_SESSION, DcmDsdSidTabSessionLevelRef=DCM_EXTENDED_DIAGNOSTIC_SESSION, DcmDsdSidTabSessionLevelRef=DCM_EXTENDED_DIAGNOSTIC_MODE
              16 x DcmDsdSubService:
                reportNumberOfDTCByStatusMask: DcmDsdSubServiceId=0x01
                reportDTCByStatusMask: DcmDsdSubServiceId=0x02
                reportDTCSnapshotIdentification: DcmDsdSubServiceId=0x03
                reportDTCSnapshotRecordByDTCNumber: DcmDsdSubServiceId=0x04
                reportDTCExtendedDataRecordByDTCNumber: DcmDsdSubServiceId=0x06
                reportNumberOfDTCBySeverityMaskRecord: DcmDsdSubServiceId=0x07
                reportDTCBySeverityMaskRecord: DcmDsdSubServiceId=0x08
                reportSeverityInformationOfDTC: DcmDsdSubServiceId=0x09
                reportSupportedDTC: DcmDsdSubServiceId=0x0A
                reportFirstTestFailedDTC: DcmDsdSubServiceId=0x0B
                reportFirstConfirmedDTC: DcmDsdSubServiceId=0x0C
                reportMostRecentTestFailedDTC: DcmDsdSubServiceId=0x0D
                reportMostRecentConfirmedDTC: DcmDsdSubServiceId=0x0E
                reportMirrorMemoryDTCByStatusMask: DcmDsdSubServiceId=0x0F
                reportDTCFaultDetectionCounter: DcmDsdSubServiceId=0x14
                reportDTCWithPermanentStatus: DcmDsdSubServiceId=0x15
            SID14_ClearDiagnosticInformation: DcmDsdSidTabServiceId=0x14, DcmDsdSidTabSubfuncAvail=0, DcmDsdSidTabSessionLevelRef=DCM_DEFAULT_SESSION, DcmDsdSidTabSessionLevelRef=DCM_EXTENDED_DIAGNOSTIC_SESSION, DcmDsdSidTabSessionLevelRef=DCM_EXTENDED_DIAGNOSTIC_MODE
            SID2F_InputOutputControlByIdentifier: DcmDsdSidTabServiceId=0x2F, DcmDsdSidTabSubfuncAvail=0, DcmDsdSidTabSessionLevelRef=DCM_EXTENDED_DIAGNOSTIC_SESSION, DcmDsdSidTabSessionLevelRef=DCM_EXTENDED_DIAGNOSTIC_MODE
            SID31_RoutineControl: DcmDsdSidTabServiceId=0x31, DcmDsdSidTabSubfuncAvail=1, DcmDsdSidTabSessionLevelRef=DCM_DEFAULT_SESSION, DcmDsdSidTabSessionLevelRef=DCM_PROGRAMMING_SESSION, DcmDsdSidTabSessionLevelRef=DCM_ECU_PROGRAMMING_MODE, DcmDsdSidTabSessionLevelRef=DCM_EXTENDED_DIAGNOSTIC_SESSION, DcmDsdSidTabSessionLevelRef=DCM_EXTENDED_DIAGNOSTIC_MODE, DcmDsdSidTabSessionLevelRef=DCM_SAFETY_SYSTEM_DIAGNOSTIC_SESSION
              3 x DcmDsdSubService:
                startRoutine: DcmDsdSubServiceId=0x01
                stopRoutine: DcmDsdSubServiceId=0x02
                requestRoutineResults: DcmDsdSubServiceId=0x03
      DcmDsl: category=TOOL_CONFIGURED
        UDS_RX (DcmDslBuffer): DcmDslBufferSize=620
        UDS_TX (DcmDslBuffer): DcmDslBufferSize=255
        ECU1 (DcmDslCallbackDCMRequestService)
        DcmDslDiagResp: DcmDslDiagRespMaxNumRespPend=5, DcmDslDiagRespOnSecondDeclinedRequest=0
        Dcm_DiagCom_Protocol (DcmDslProtocol): category=TOOL_CONFIGURED
          UDS_ON_CAN (DcmDslProtocolRow):
            category = TOOL_CONFIGURED
            DcmDslProtocolEndiannessConvEnabled = 0
            DcmDslProtocolID = DCM_UDS_ON_CAN
            DcmDslProtocolIsParallelExecutab = 1
            DcmDslProtocolPreemptTimeout = 0.01
            DcmDslProtocolPriority = 1
            DcmDslProtocolTransType = TYPE2
            DcmSendRespPendOnTransToBoot = 1
            DcmTimStrP2ServerAdjust = 0.02
            DcmTimStrP2StarServerAdjust = 2.5
            DcmDslProtocolRxBufferID = UDS_RX
            DcmDslProtocolSIDTable = ES95486_SERVICE
            DcmDslProtocolSessionRef = ES95486_SESSION
            DcmDslProtocolTxBufferID = UDS_TX
            UDS_ON_CAN (DcmDslConnection): category=TOOL_CONFIGURED
              MainConnection (DcmDslMainConnection): category=TOOL_CONFIGURED, DcmDslProtocolRxTesterSourceAddr=0xf0
                FunctionalRequest (DcmDslProtocolRx):
                  category = TOOL_CONFIGURED
                  DcmDslProtocolRxAddrType = DCM_FUNCTIONAL_TYPE
                  DcmDslProtocolRxChannelId = 0
                  DcmDslProtocolRxPduId = 1
                  DcmDslProtocolRxComMChannelRef = ComMChannel_Project
                  DcmDslProtocolRxPduRef = Pdu_DcmIPdu_Project_GST_Msg_TP_Func
                PhysicalRequest (DcmDslProtocolRx):
                  category = TOOL_CONFIGURED
                  DcmDslProtocolRxAddrType = DCM_PHYSICAL_TYPE
                  DcmDslProtocolRxChannelId = 0
                  DcmDslProtocolRxPduId = 0
                  DcmDslProtocolRxComMChannelRef = ComMChannel_Project
                  DcmDslProtocolRxPduRef = Pdu_DcmIPdu_Project_GST_Msg_TP_Phys
                Response (DcmDslProtocolTx): category=TOOL_CONFIGURED, DcmDslTxConfirmationPduId=0, DcmDslProtocolTxPduRef=Pdu_DcmIPdu_Project_ECU1_GST_Msg_TP
        DcmDslServiceRequestSupplierNotification0 (DcmDslServiceRequestSupplierNotification)
      DcmDsp: DcmDspMaxDidToRead=32, DcmDspPowerDownTime=10, DcmDspMaxPeriodicDidScheduler=2, DcmDspMaxPeriodicDidToRead=2, DcmDspDDDIDcheckPerSourceDID=0
        DcmDspComControl0 (DcmDspComControl)
          CanChannel_0 (DcmDspComControlAllChannel): DcmDspAllComMChannelRef=ComMChannel_Project
          SpecificCanChannel_0 (DcmDspComControlSpecificChannel): DcmDspSubnetNumber=1, DcmDspSpecificComMChannelRef=ComMChannel_Project
        9 x DcmDspData, all with DcmDspDataType=UINT8, DcmDspDataUsePort=USE_DATA_SYNCH_CLIENT_SERVER:
          VehicleManufacturerECUSoftwareVersionNumber: DcmDspDataSize=136, DcmDspDataInfoRef=NoScalingInfomation_FixedData
          SystemSupplierECUHardwareVersionNumber: DcmDspDataSize=32, DcmDspDataInfoRef=NoScalingInfomation_FixedData
          SystemSupplierECUSoftwareNumber: DcmDspDataSize=32, DcmDspDataInfoRef=NoScalingInfomation_FixedData
          VehicleSpeed: DcmDspDataSize=8, DcmDspDataInfoRef=VehicleSpeed_FixedData
          ActuatorControl: DcmDspDataSize=8, DcmDspDataInfoRef=NoScalingInfomation_FixedData
          VINDataIdentifier: DcmDspDataSize=136, DcmDspDataInfoRef=VIN_DataIdentifier
          BatVolt: DcmDspDataSize=8, DcmDspDataInfoRef=NoScalingInfomation_FixedData
          RPM: DcmDspDataSize=16, DcmDspDataInfoRef=NoScalingInfomation_FixedData
          ECT: DcmDspDataSize=8, DcmDspDataInfoRef=NoScalingInfomation_FixedData
        4 x DcmDspDataInfo:
          VehicleSpeed_FixedData: DcmDspDataFixedLength=1, DcmDspDataScalingInfoSize=9
          NoScalingInfomation_FixedData: DcmDspDataFixedLength=1
          NoScalingInfomation_VariableData: DcmDspDataFixedLength=0
          VIN_DataIdentifier: DcmDspDataFixedLength=1, DcmDspDataScalingInfoSize=2
        14 x DcmDspDid, all with DcmDspDidUsed=1:
          DID_0201h_VehicleSpeed: DcmDspDidIdentifier=0x0201, DcmDspDidInfoRef=DIDInfo_0201h_VehicleSpeed
            VehicleSpeed (DcmDspDidSignal): DcmDspDidDataPos=0, DcmDspDidDataRef=DcmDsp/VehicleSpeed
          DID_F189h_VehicleManufacturerECUSoftwareVersionNumber: DcmDspDidIdentifier=0xF189, DcmDspDidInfoRef=DcmDsp/DID_F189h_VehicleManufacturerECUSoftwareVersionNumber
            VehicleManufacturerECUSoftwareVersionNumber (DcmDspDidSignal): DcmDspDidDataPos=0, DcmDspDidDataRef=DcmDsp/VehicleManufacturerECUSoftwareVersionNumber
          DID_F193h_SystemSupplierECUHardwareVersionNumber: DcmDspDidIdentifier=0xF193, DcmDspDidInfoRef=DcmDsp/DID_F193h_SystemSupplierECUHardwareVersionNumber
            SystemSupplierECUHardwareVersionNumber (DcmDspDidSignal): DcmDspDidDataPos=0, DcmDspDidDataRef=DcmDsp/SystemSupplierECUHardwareVersionNumber
          DID_F194h_SystemSupplierECUSoftwareNumber: DcmDspDidIdentifier=0xF194, DcmDspDidInfoRef=DcmDsp/DID_F194h_SystemSupplierECUSoftwareNumber
            SystemSupplierECUSoftwareNumber (DcmDspDidSignal): DcmDspDidDataPos=0, DcmDspDidDataRef=DcmDsp/SystemSupplierECUSoftwareNumber
          DID_F190h_VINDataIdentifier: DcmDspDidIdentifier=0xF190, DcmDspDidInfoRef=DcmDsp/DID_F190h_VINDataIdentifier
            DcmDspDidSignal: DcmDspDidDataPos=0, DcmDspDidDataRef=VINDataIdentifier
          DID_010A: DcmDspDidIdentifier=0x010A, DcmDspDidInfoRef=DID_010Ah
            3 x DcmDspDidSignal:
              BatVolt: DcmDspDidDataPos=0, DcmDspDidDataRef=DcmDsp/BatVolt
              RPM: DcmDspDidDataPos=8, DcmDspDidDataRef=DcmDsp/RPM
              ECT: DcmDspDidDataPos=24, DcmDspDidDataRef=DcmDsp/ECT
          DDID_F301h: DcmDspDidIdentifier=0xF301, DcmDspDidInfoRef=DDID_F301
          DDID_F302: DcmDspDidIdentifier=0xF302, DcmDspDidInfoRef=DDID_F302h
          DDID_F303: DcmDspDidIdentifier=0xF303, DcmDspDidInfoRef=DDID_F303h
          IO_F010h_ActuatorControl: DcmDspDidIdentifier=0xF010, DcmDspDidInfoRef=DcmDsp/IO_F010h_ActuatorControl
            ActuatorControl (DcmDspDidSignal): DcmDspDidDataPos=0, DcmDspDidDataRef=DcmDsp/ActuatorControl
          IO_F012h_MultipleActuatorControl: DcmDspDidIdentifier=0xF012, DcmDspDidInfoRef=IO_F010h_MultiActuatorControl
            ActuatorControl (DcmDspDidSignal): DcmDspDidDataPos=0, DcmDspDidDataRef=DcmDsp/ActuatorControl
            RPM (DcmDspDidSignal): DcmDspDidDataPos=8, DcmDspDidDataRef=DcmDsp/RPM
          PDID_F2E3: DcmDspDidIdentifier=0xF2E3, DcmDspDidInfoRef=pDID_F2E3h
            AC (DcmDspDidSignal): DcmDspDidDataPos=0, DcmDspDidDataRef=DcmDsp/ActuatorControl
            BatVolt (DcmDspDidSignal): DcmDspDidDataPos=8, DcmDspDidDataRef=DcmDsp/BatVolt
          PDID_F224: DcmDspDidIdentifier=0xF224, DcmDspDidInfoRef=pDID_F2E3h
            RPM (DcmDspDidSignal): DcmDspDidDataPos=0, DcmDspDidDataRef=DcmDsp/RPM
            ECT (DcmDspDidSignal): DcmDspDidDataPos=16, DcmDspDidDataRef=DcmDsp/ECT
          PDID_F232: DcmDspDidIdentifier=0xF232, DcmDspDidInfoRef=PDID_F232h
            3 x DcmDspDidSignal:
              BatVolt: DcmDspDidDataPos=0, DcmDspDidDataRef=DcmDsp/BatVolt
              RPM: DcmDspDidDataPos=8, DcmDspDidDataRef=DcmDsp/RPM
              ECT: DcmDspDidDataPos=32, DcmDspDidDataRef=DcmDsp/ECT
        15 x DcmDspDidInfo:
          DIDs_0100h_0110h: DcmDspDidDynamicallyDefined=0
            DcmDspDidAccess
              DcmDspDidRead
              DcmDspDidWrite: DcmDspDidWriteSessionRef=DCM_ALL_SESSION_LEVEL
          DIDInfo_0201h_VehicleSpeed: DcmDspDidDynamicallyDefined=0
            DcmDspDidAccess
              DcmDspDidRead
          DID_F189h_VehicleManufacturerECUSoftwareVersionNumber: DcmDspDidDynamicallyDefined=0
            DcmDspDidAccess
              DcmDspDidRead
          DID_F193h_SystemSupplierECUHardwareVersionNumber: DcmDspDidDynamicallyDefined=0
            DcmDspDidAccess
              DcmDspDidRead
          DID_F194h_SystemSupplierECUSoftwareNumber: DcmDspDidDynamicallyDefined=0
            DcmDspDidAccess
              DcmDspDidRead
          DID_F190h_VINDataIdentifier: DcmDspDidDynamicallyDefined=0
            DcmDspDidAccess
              DcmDspDidRead
              DcmDspDidWrite
          DDID_F301: DcmDspDidDynamicallyDefined=1
            DcmDspDidAccess
              DcmDspDidRead: DcmDspDDDIDMaxElements=3
          DID_010Ah: DcmDspDidDynamicallyDefined=0
            DcmDspDidAccess
              DcmDspDidRead: DcmDspDDDIDMaxElements=2
          DDID_F302h: DcmDspDidDynamicallyDefined=1
            DcmDspDidAccess
              DcmDspDidRead: DcmDspDDDIDMaxElements=3
          DDID_F303h: DcmDspDidDynamicallyDefined=1
            DcmDspDidAccess
              DcmDspDidRead: DcmDspDDDIDMaxElements=4
          IO_F010h_ActuatorControl: DcmDspDidDynamicallyDefined=0
            DcmDspDidAccess
              DcmDspDidControl:
                DcmDspDidFreezeCurrentState = 1
                DcmDspDidResetToDefault = 1
                DcmDspDidReturnControlToEcu = 1
                DcmDspDidShortTermAdjustment = 1
                DcmDspDidControlSecurityLevelRef = L1
                DcmDspDidControlSessionRef = DCM_EXTENDED_DIAGNOSTIC_SESSION
              DcmDspDidRead: DcmDspDidReadSecurityLevelRef=L1, DcmDspDidReadSessionRef=DCM_EXTENDED_DIAGNOSTIC_SESSION
              DcmDspDidWrite: DcmDspDidWriteSecurityLevelRef=L1, DcmDspDidWriteSessionRef=DCM_EXTENDED_DIAGNOSTIC_SESSION
          IO_F010h_MultiActuatorControl: DcmDspDidDynamicallyDefined=0
            DcmDspDidAccess
              DcmDspDidControl:
                DcmDspDidFreezeCurrentState = 1
                DcmDspDidResetToDefault = 0
                DcmDspDidReturnControlToEcu = 1
                DcmDspDidShortTermAdjustment = 1
                DcmDspDidControlSecurityLevelRef = L1
                DcmDspDidControlSessionRef = DCM_EXTENDED_DIAGNOSTIC_SESSION
              DcmDspDidRead: DcmDspDidReadSecurityLevelRef=L1, DcmDspDidReadSessionRef=DCM_EXTENDED_DIAGNOSTIC_SESSION
          pDID_F2E3h: DcmDspDidDynamicallyDefined=0
            DcmDspDidAccess
              DcmDspDidRead: DcmDspDidReadSecurityLevelRef=L1, DcmDspDidReadSessionRef=DCM_EXTENDED_DIAGNOSTIC_SESSION
              DcmDspDidWrite: DcmDspDidWriteSecurityLevelRef=L1, DcmDspDidWriteSessionRef=DCM_EXTENDED_DIAGNOSTIC_SESSION
          PDID_F232h: DcmDspDidDynamicallyDefined=0
            DcmDspDidAccess
              DcmDspDidRead: DcmDspDidReadSessionRef=DCM_EXTENDED_DIAGNOSTIC_MODE
          pDID_F224h: DcmDspDidDynamicallyDefined=0
            DcmDspDidAccess
              DcmDspDidRead: DcmDspDidReadSecurityLevelRef=L1, DcmDspDidReadSessionRef=DCM_EXTENDED_DIAGNOSTIC_MODE, DcmDspDidReadSessionRef=DCM_EXTENDED_DIAGNOSTIC_SESSION
              DcmDspDidWrite:
                DcmDspDidWriteSecurityLevelRef = L1
                DcmDspDidWriteSessionRef = DCM_EXTENDED_DIAGNOSTIC_MODE
                DcmDspDidWriteSessionRef = DCM_EXTENDED_DIAGNOSTIC_SESSION
        DIDs_0100h_0110h (DcmDspDidRange):
          DcmDspDidRangeHasGaps = 1
          DcmDspDidRangeIdentifierLowerLimit = 0x0100
          DcmDspDidRangeIdentifierUpperLimit = 0x0110
          DcmDspDidRangeMaxDataLength = 30
          DcmDspDidRangeUsePort = 1
          DcmDspDidRangeInfoRef = DcmDsp/DIDs_0100h_0110h
        DcmDspMemory: DcmDspUseMemoryId=0
          ALF_0x14h (DcmDspAddressAndLengthFormatIdentifier): DcmDspSupportedAddressAndLengthFormatIdentifier=0x14
          MemoryIdInfo (DcmDspMemoryIdInfo)
            RMA_21091968h (DcmDspReadMemoryRangeInfo): DcmDspReadMemoryRangeHigh=0x2109196C, DcmDspReadMemoryRangeLow=0x21091968
            WMA_20481309h (DcmDspWriteMemoryRangeInfo): DcmDspWriteMemoryRangeHigh=0x2048130E, DcmDspWriteMemoryRangeLow=0x20481309
        RID_0200h_CalibrationActuator (DcmDspRoutine):
          DcmDspRequestResultsRoutineSupported = 1
          DcmDspRoutineFixedLength = 1
          DcmDspRoutineIdentifier = 0x0200
          DcmDspRoutineUsePort = 1
          DcmDspRoutineUsed = 1
          DcmDspStopRoutineSupported = 1
          DcmDspRoutineInfoRef = DcmDsp/RID_0200h_CalibrationActuator
        RID_0200h_CalibrationActuator (DcmDspRoutineInfo)
          DcmDspRoutineAuthorization0 (DcmDspRoutineAuthorization): DcmDspRoutineSecurityLevelRef=L1, DcmDspRoutineSessionRef=DCM_EXTENDED_DIAGNOSTIC_MODE, DcmDspRoutineSessionRef=DCM_EXTENDED_DIAGNOSTIC_SESSION
          routineStatus_ResOutSignal (DcmDspRoutineRequestResOut)
            routineStatus_ResOutSignal (DcmDspRoutineRequestResOutSignal): DcmDspRoutineSignalLength=8, DcmDspRoutineSignalPos=0, DcmDspRoutineSignalType=UINT8, DcmDspRoutineRequestEndianness=0
          DcmDspRoutineStopIn
            DcmDspRoutineStopInSignal0 (DcmDspRoutineStopInSignal): DcmDspRoutineSignalLength=8, DcmDspRoutineSignalPos=0, DcmDspRoutineSignalType=UINT8, DcmDspRoutineStopInEndianness=0
          DcmDspRoutineStopOut
            DcmDspRoutineStopOutSignal0 (DcmDspRoutineStopOutSignal): DcmDspRoutineSignalLength=8, DcmDspRoutineSignalPos=0, DcmDspRoutineSignalType=UINT8, DcmDspRoutineStopOutEndianness=0
          routineControlOption_StartIn (DcmDspStartRoutineIn)
            routineControlOption_StartInSignal (DcmDspStartRoutineInSignal): DcmDspRoutineSignalLength=7, DcmDspRoutineSignalPos=0, DcmDspRoutineSignalType=UINT8, DcmDspRoutineStartInEndianness=0
          routineStatus_StartOutSignal (DcmDspStartRoutineOut)
            routineStatus_StartOutSignal (DcmDspStartRoutineOutSignal): DcmDspRoutineSignalLength=8, DcmDspRoutineSignalPos=0, DcmDspRoutineSignalType=UINT8, DcmDspRoutineStartOutEndianness=0
        ES95486_SECURITY (DcmDspSecurity)
          L1 (DcmDspSecurityRow):
            DcmDspSecurityDelayTime = 10.0
            DcmDspSecurityDelayTimeOnBoot = 0
            DcmDspSecurityKeySize = 4
            DcmDspSecurityLevel = 1
            DcmDspSecurityNumAttDelay = 2
            DcmDspSecuritySeedSize = 4
            DcmDspSecurityUsePort = USE_ASYNCH_CLIENT_SERVER
          L9 (DcmDspSecurityRow):
            DcmDspSecurityDelayTime = 10.0
            DcmDspSecurityDelayTimeOnBoot = 0.0
            DcmDspSecurityKeySize = 8
            DcmDspSecurityLevel = 0x09
            DcmDspSecurityNumAttDelay = 2
            DcmDspSecuritySeedSize = 8
            DcmDspSecurityUsePort = USE_ASYNCH_CLIENT_SERVER
        ES95486_SESSION (DcmDspSession)
          9 x DcmDspSessionRow, all with DcmDspSessionP2ServerMax=0.05, DcmDspSessionP2StarServerMax=5.0:
            DCM_DEFAULT_SESSION: DcmDspSessionForBoot=DCM_NO_BOOT, DcmDspSessionLevel=0x01
            DCM_PROGRAMMING_SESSION: DcmDspSessionForBoot=DCM_OEM_BOOT, DcmDspSessionLevel=0x02
            DCM_EXTENDED_DIAGNOSTIC_SESSION: DcmDspSessionForBoot=DCM_NO_BOOT, DcmDspSessionLevel=0x03
            DCM_SAFETY_SYSTEM_DIAGNOSTIC_SESSION: DcmDspSessionForBoot=DCM_NO_BOOT, DcmDspSessionLevel=0x04
            DCM_ECU_PROGRAMMING_MODE: DcmDspSessionForBoot=DCM_OEM_BOOT, DcmDspSessionLevel=0x05
            DCM_EXTENDED_DIAGNOSTIC_MODE: DcmDspSessionForBoot=DCM_NO_BOOT, DcmDspSessionLevel=0x10
            DCM_QUIESCENT_CURRENT_DIAGNOSTIC_MODE: DcmDspSessionForBoot=DCM_NO_BOOT, DcmDspSessionLevel=0x50
            DCM_SLEEP_MODE_START_REQUEST: DcmDspSessionForBoot=DCM_NO_BOOT, DcmDspSessionLevel=0x51
            DCM_ALL_SESSION_LEVEL: DcmDspSessionForBoot=DCM_NO_BOOT, DcmDspSessionLevel=0xFF
      DcmGeneral:
        DcmDevErrorDetect = 1
        DcmRequestManufacturerNotificationEnabled = 0
        DcmRequestSupplierNotificationEnabled = 1
        DcmRespondAllRequest = 1
        DcmTaskTime = 0.01
        DcmVersionInfoApi = 0
        DcmStandardSupport = DCM_ES95486_SUPPORT
        DcmHeaderFileInclusion = Dcm_DspSecureServices.h
        DcmAutronFblUsed = 1
      DcmPageBufferCfg: DcmPagedBufferEnabled=0
