AUTOSAR XML (schema 4-0-3)
package /ECU_EXTRACT
  system EcuExtract: category=ECU_EXTRACT
    system mapping DataMappings
      data-mappings:
        communication-direction=IN, data-element=App_CC.RootSwCompositionPrototype.CC_Recv1.TARGET_SPEED, system-signal=SystemSignal_CC_Recv1_TARGET_SPEED
        communication-direction=OUT, data-element=App_CC.RootSwCompositionPrototype.CC_Send.ACCEL, system-signal=SystemSignal_CC_Send_ACCEL
        communication-direction=IN, data-element=App_CC.RootSwCompositionPrototype.CC_Recv2.CC_TRIGGER, system-signal=SystemSignal_CC_Recv2_CC_TRIGGER
        communication-direction=OUT, data-element=App_CC.RootSwCompositionPrototype.CC_Send.BRAKE, system-signal=SystemSignal_CC_Send_BRAKE
        communication-direction=IN, data-element=App_CC.RootSwCompositionPrototype.CC_Recv1.ACCEL_VALUE, system-signal=SystemSignal_CC_Recv1_ACCEL_VALUE
        communication-direction=IN, data-element=App_CC.RootSwCompositionPrototype.CC_Recv2.SPEED, system-signal=SystemSignal_CC_Recv2_SPEED
        communication-direction=IN, data-element=App_LKAS.RootSwCompositionPrototype.LKAS_Recv.STEER_VALUE, system-signal=SystemSignal_LKAS_Recv_STEER_VALUE
        communication-direction=OUT, data-element=App_LKAS.RootSwCompositionPrototype.LKAS_Send.RIGHT_STEER, system-signal=SystemSignal_LKAS_Send_RIGHT_STEER
        communication-direction=OUT, data-element=App_LKAS.RootSwCompositionPrototype.LKAS_Send.LEFT_STEER, system-signal=SystemSignal_LKAS_Send_LEFT_STEER
        communication-direction=IN, data-element=App_LKAS.RootSwCompositionPrototype.LKAS_Recv.LKAS_TRIGGER, system-signal=SystemSignal_LKAS_Recv_LKAS_TRIGGER
    system mapping SwMappings
      sw-mappings:
        swc to ecu mapping SwMapping0: ecu-instance=ECU1
          component:
            RootSwCompositionPrototype.App_CC
            RootSwCompositionPrototype.App_LKAS
            RootSwCompositionPrototype.SWC_Actuator
            RootSwCompositionPrototype.SWC_AppMode
            RootSwCompositionPrototype.SWC_ComM
            RootSwCompositionPrototype.SWC_DiagnosticMonitor
            RootSwCompositionPrototype.SWC_DiagnosticService
            RootSwCompositionPrototype.SWC_ErrM
            RootSwCompositionPrototype.SWC_TestModeManager
            RootSwCompositionPrototype.SWC_TestModeUser
            RootSwCompositionPrototype.SWC_WdgMTest
            RootSwCompositionPrototype.Svc_IoHwAb
            RootSwCompositionPrototype.BswM
            RootSwCompositionPrototype.ComM
            RootSwCompositionPrototype.Dcm
            RootSwCompositionPrototype.Dem
            RootSwCompositionPrototype.Det
            RootSwCompositionPrototype.EcuM
            RootSwCompositionPrototype.FiM
            RootSwCompositionPrototype.NvM
            RootSwCompositionPrototype.WdgM
    root-software-compositions:
      root sw composition prototype RootSwCompositionPrototype: software-composition=EcuComposition
  ecu instance ECU1: associated-com-i-pdu-group=[ISignalIPduGroupRx_ECU1_Project, ISignalIPduGroupTx_ECU1_Project]
    can communication controller ECU1_Project
    can communication connector Conn_ECU1_Project: comm-controller=ECU1_Project
  composition sw component type EcuComposition
    21 x component:
      App_CC: type=App_CC
      App_LKAS: type=App_LKAS
      SWC_Actuator: type=SWC_Actuator
      SWC_AppMode: type=SWC_AppMode
      SWC_ComM: type=SWC_ComM
      SWC_DiagnosticMonitor: type=SWC_DiagnosticMonitor
      SWC_DiagnosticService: type=SWC_DiagnosticService
      SWC_ErrM: type=SWC_ErrM
      SWC_TestModeManager: type=SWC_TestModeManager
      SWC_TestModeUser: type=SWC_TestModeUser
      SWC_WdgMTest: type=SWC_WdgMTest
      Svc_IoHwAb: type=IoHwAb
      BswM: type=BswM
      ComM: type=ComM
      Dcm: type=Dcm
      Dem: type=Dem
      Det: type=Det
      EcuM: type=EcuM
      FiM: type=FiM
      NvM: type=NvM
      WdgM: type=WdgM
    connect SWC_DiagnosticMonitor.CBReadData_DE_0001 -> Dem.CBReadData_DE_0001
    connect SWC_DiagnosticMonitor.CBReadData_DE_0002 -> Dem.CBReadData_DE_0002
    connect SWC_DiagnosticMonitor.CBStatusEvt_DEM_E_TEST_EVENT1 -> Dem.CBStatusEvt_DEM_E_TEST_EVENT1_DemCallbackEventStatusChanged0
    connect SWC_DiagnosticService.CallbackDCMRequestServices -> Dcm.CallbackDCMRequestServices_ECU1
    connect Dcm.DCMServices -> SWC_DiagnosticService.DCM_Services
    connect Det.DS000 -> SWC_DiagnosticMonitor.DS000
    connect SWC_DiagnosticService.DataServices_ActuatorControl -> Dcm.DataServices_ActuatorControl
    connect SWC_DiagnosticService.DataServices_BatVolt -> Dcm.DataServices_BatVolt
    connect SWC_DiagnosticService.DataServices_DIDRange_DID_0100h_0110h -> Dcm.DataServices_DIDRange_DIDs_0100h_0110h
    connect SWC_DiagnosticService.DataServices_ECT -> Dcm.DataServices_ECT
    connect SWC_DiagnosticService.DataServices_RPM -> Dcm.DataServices_RPM
    connect SWC_DiagnosticService.DataServices_SystemSupplierECUHardwareVersionNumber -> Dcm.DataServices_SystemSupplierECUHardwareVersionNumber
    connect SWC_DiagnosticService.DataServices_SystemSupplierECUSoftwareNumber -> Dcm.DataServices_SystemSupplierECUSoftwareNumber
    connect SWC_DiagnosticService.DataServices_VINDataIdentifier -> Dcm.DataServices_VINDataIdentifier
    connect SWC_DiagnosticService.DataServices_VehicleManufacturerECUSoftwareVersionNumber -> Dcm.DataServices_VehicleManufacturerECUSoftwareVersionNumber
    connect SWC_DiagnosticService.DataServices_VehicleSpeed -> Dcm.DataServices_VehicleSpeed
    connect Dem.EnableCond_DemEnableCondition -> SWC_DiagnosticMonitor.EnableCond_EnableCondtion_0
    connect Dem.Event_DEM_E_TEST_EVENT{1..4} -> SWC_DiagnosticMonitor.Event_DEM_E_TEST_EVENT{1..4}
    connect FiM.Func_FiMFID_0 -> SWC_Actuator.R_Func_FiMFID_0
    connect FiM.Func_FiMFID_1 -> SWC_Actuator.R_Func_FiMFID_1
    connect SWC_ErrM.GeneralCBStatusEvt -> Dem.GeneralCBStatusEvt
    connect Dem.IndStatus_DemIndicator_0 -> SWC_DiagnosticMonitor.IndStatus_DemIndicator_0
    connect SWC_DiagnosticMonitor.InitEvt_DEM_E_TEST_EVENT -> Dem.CBInitEvt_DEM_E_TEST_EVENT1
    connect Dem.OpCycle_DemOperationCycle0 -> SWC_DiagnosticMonitor.OpCycle_POWER_CYCLE
    connect SWC_DiagnosticService.RoutineServices_RID_0200h_CalibrationActuator -> Dcm.RoutineServices_RID_0200h_CalibrationActuator
    connect SWC_DiagnosticService.SecurityAccess_L1 -> Dcm.SecurityAccess_L1
    connect SWC_DiagnosticService.ServiceRequestSupplierNotification_DcmDslServiceRequestSupplierNotification0 -> Dcm.ServiceRequestSupplierNotification_DcmDslServiceRequestSupplierNotification0
    connect WdgM.WdgM_API_P -> SWC_WdgMTest.WdgM_API_R
    connect WdgM.alive_SE_Init -> SWC_WdgMTest.SE_Init
    connect WdgM.alive_SE_WdgMTest -> SWC_WdgMTest.SE_WdgMTest
    connect WdgM.globalMode -> SWC_WdgMTest.globalMode
    connect SWC_AppMode.modeRequestPort_AppMode -> BswM.modeRequestPort_AppMode
    connect SWC_ErrM.modeRequestPort_AppMode -> BswM.modeRequestPort_AppMode
    connect SWC_AppMode.modeRequestPort_ComMMode_Project -> BswM.modeRequestPort_ComMMode_Project
    connect BswM.modeSwitchPort_ComMMode_Project -> SWC_AppMode.modeNotificationPort_ComMMode_Project
    connect BswM.modeSwitchPort_DcmDiagnosticSessionControl -> SWC_DiagnosticService.modeNotificationPort_SessionControl
    connect BswM.modeSwitchPort_EcuMode -> SWC_AppMode.modeNotificationPort_EcuMode
    connect BswM.modeSwitchPort_InitState -> SWC_AppMode.modeNotificationPort_InitState
    connect BswM.modeSwitchPort_PduGroupRx_Project -> SWC_AppMode.modeNotificationPort_PduGroupRx_Project
    connect BswM.modeSwitchPort_PduGroupTx_Project -> SWC_AppMode.modeNotificationPort_PduGroupTx_Project
