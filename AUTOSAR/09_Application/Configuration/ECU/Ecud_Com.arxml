AUTOSAR XML (schema 4-0-3)
package /AUTOSAR
  module config Com: implementation-config-variant=VARIANT-PRE-COMPILE, module-description=BswImplementation_Com
    ComConfig: ComConfigurationId=0
      20 x ComIPdu, all with category=TOOL_CONFIGURED, ComIPduSignalProcessing=DEFERRED:
        ComIPdu_ECU1_Msg_GW1: ComIPduDirection=SEND, ComIPduHandleId=5, ComIPduType=NORMAL, ComPduIdRef=Pdu_ISignalIPdu_ECU1_Msg_GW1, ComIPduGroupRef=ComIPduGroupTx_ECU1_Project, ComIPduSignalRef=ComISignal_ECU1_Msg_GW1_ECU1_Msg_GW1_Sig2, ComIPduSignalRef=ComISignal_ECU1_Msg_GW1_ECU1_Msg_GW1_Sig1
          ComTxIpdu_ComIPdu_ECU1_Msg_GW1 (ComTxIPdu): category=TOOL_CONFIGURED, ComMinimumDelayTime=0.02, ComTxIPduUnusedAreasDefault=0
            ComTxModeTrue_ComTxIpdu_ComIPdu_ECU1_Msg_GW1 (ComTxModeTrue): category=TOOL_CONFIGURED
              ComTxMode_ComTxModeTrue_ComTxIpdu_ComIPdu_ECU1_Msg_GW1 (ComTxMode): category=TOOL_CONFIGURED, ComTxModeMode=DIRECT, ComTxModeNumberOfRepetitions=3, ComTxModeRepetitionPeriod=0.04
        ComIPdu_ECU1_Msg_IF1: ComIPduDirection=SEND, ComIPduHandleId=4, ComIPduType=NORMAL, ComPduIdRef=Pdu_ISignalIPdu_ECU1_Msg_IF1, ComIPduGroupRef=ComIPduGroupTx_ECU1_Project, ComIPduSignalRef=ComISignal_ECU1_Msg_IF1_ECU1_Msg_IF1_Sig2, ComIPduSignalRef=ComISignal_ECU1_Msg_IF1_ECU1_Msg_IF1_Sig1
          ComTxIpdu_ComIPdu_ECU1_Msg_IF1 (ComTxIPdu): category=TOOL_CONFIGURED, ComMinimumDelayTime=0.02, ComTxIPduUnusedAreasDefault=0
            ComTxModeTrue_ComTxIpdu_ComIPdu_ECU1_Msg_IF1 (ComTxModeTrue): category=TOOL_CONFIGURED
              ComTxMode_ComTxModeTrue_ComTxIpdu_ComIPdu_ECU1_Msg_IF1 (ComTxMode): category=TOOL_CONFIGURED, ComTxModeMode=DIRECT, ComTxModeNumberOfRepetitions=3, ComTxModeRepetitionPeriod=0.2
        ComIPdu_ECU1_Msg_OE1: ComIPduDirection=SEND, ComIPduHandleId=7, ComIPduType=NORMAL, ComPduIdRef=Pdu_ISignalIPdu_ECU1_Msg_OE1, ComIPduGroupRef=ComIPduGroupTx_ECU1_Project, ComIPduSignalRef=ComISignal_ECU1_Msg_OE1_ECU1_Msg_OE1_Sig2, ComIPduSignalRef=ComISignal_ECU1_Msg_OE1_ECU1_Msg_OE1_Sig1
          ComTxIpdu_ComIPdu_ECU1_Msg_OE1 (ComTxIPdu): category=TOOL_CONFIGURED, ComMinimumDelayTime=0.02, ComTxIPduUnusedAreasDefault=0
            ComTxModeTrue_ComTxIpdu_ComIPdu_ECU1_Msg_OE1 (ComTxModeTrue): category=TOOL_CONFIGURED
              ComTxMode_ComTxModeTrue_ComTxIpdu_ComIPdu_ECU1_Msg_OE1 (ComTxMode): category=TOOL_CONFIGURED, ComTxModeMode=DIRECT, ComTxModeNumberOfRepetitions=3, ComTxModeRepetitionPeriod=0.04
        ComIPdu_ECU1_Msg_OE2: ComIPduDirection=SEND, ComIPduHandleId=6, ComIPduType=NORMAL, ComPduIdRef=Pdu_ISignalIPdu_ECU1_Msg_OE2, ComIPduGroupRef=ComIPduGroupTx_ECU1_Project, ComIPduSignalRef=ComISignal_ECU1_Msg_OE2_ECU1_Msg_OE2_Sig5, ComIPduSignalRef=ComISignal_ECU1_Msg_OE2_ECU1_Msg_OE2_Sig4, ComIPduSignalRef=ComISignal_ECU1_Msg_OE2_ECU1_Msg_OE2_Sig3, ComIPduSignalRef=ComISignal_ECU1_Msg_OE2_ECU1_Msg_OE2_Sig2, ComIPduSignalRef=ComISignal_ECU1_Msg_OE2_ECU1_Msg_OE2_Sig1
          ComTxIpdu_ComIPdu_ECU1_Msg_OE2 (ComTxIPdu): category=TOOL_CONFIGURED, ComMinimumDelayTime=0.02, ComTxIPduUnusedAreasDefault=0
            ComTxModeTrue_ComTxIpdu_ComIPdu_ECU1_Msg_OE2 (ComTxModeTrue): category=TOOL_CONFIGURED
              ComTxMode_ComTxModeTrue_ComTxIpdu_ComIPdu_ECU1_Msg_OE2 (ComTxMode): category=TOOL_CONFIGURED, ComTxModeMode=DIRECT, ComTxModeNumberOfRepetitions=3, ComTxModeRepetitionPeriod=0.04
        ComIPdu_ECU1_Msg_P1: ComIPduDirection=SEND, ComIPduHandleId=8, ComIPduType=NORMAL, ComPduIdRef=Pdu_ISignalIPdu_ECU1_Msg_P1, ComIPduGroupRef=ComIPduGroupTx_ECU1_Project, ComIPduSignalRef=ComISignal_ECU1_Msg_P1_ECU1_Msg_P1_Sig2, ComIPduSignalRef=ComISignal_ECU1_Msg_P1_ECU1_Msg_P1_Sig1
          ComTxIpdu_ComIPdu_ECU1_Msg_P1 (ComTxIPdu): category=TOOL_CONFIGURED, ComMinimumDelayTime=0.02, ComTxIPduUnusedAreasDefault=0
            ComTxModeTrue_ComTxIpdu_ComIPdu_ECU1_Msg_P1 (ComTxModeTrue): category=TOOL_CONFIGURED
              ComTxMode_ComTxModeTrue_ComTxIpdu_ComIPdu_ECU1_Msg_P1 (ComTxMode): category=TOOL_CONFIGURED, ComTxModeMode=PERIODIC, ComTxModeTimeOffset=0.0, ComTxModeTimePeriod=0.5
        ComIPdu_ECU1_Msg_P2: ComIPduDirection=SEND, ComIPduHandleId=12, ComIPduType=NORMAL, ComPduIdRef=Pdu_ISignalIPdu_ECU1_Msg_P2, ComIPduGroupRef=ComIPduGroupTx_ECU1_Project, ComIPduSignalRef=ComISignal_ECU1_Msg_P2_ECU1_Msg_P2_Sig2, ComIPduSignalRef=ComISignal_ECU1_Msg_P2_ECU1_Msg_P2_Sig1
          ComTxIpdu_ComIPdu_ECU1_Msg_P2 (ComTxIPdu): category=TOOL_CONFIGURED, ComMinimumDelayTime=0.02, ComTxIPduUnusedAreasDefault=0
            ComTxModeTrue_ComTxIpdu_ComIPdu_ECU1_Msg_P2 (ComTxModeTrue): category=TOOL_CONFIGURED
              ComTxMode_ComTxModeTrue_ComTxIpdu_ComIPdu_ECU1_Msg_P2 (ComTxMode): category=TOOL_CONFIGURED, ComTxModeMode=PERIODIC, ComTxModeTimeOffset=0.0, ComTxModeTimePeriod=0.2
        ComIPdu_ECU1_Msg_P3: ComIPduDirection=SEND, ComIPduHandleId=11, ComIPduType=NORMAL, ComPduIdRef=Pdu_ISignalIPdu_ECU1_Msg_P3, ComIPduGroupRef=ComIPduGroupTx_ECU1_Project, ComIPduSignalRef=ComISignal_ECU1_Msg_P3_ECU1_Msg_P3_Sig2, ComIPduSignalRef=ComISignal_ECU1_Msg_P3_ECU1_Msg_P3_Sig1
          ComTxIpdu_ComIPdu_ECU1_Msg_P3 (ComTxIPdu): category=TOOL_CONFIGURED, ComMinimumDelayTime=0.02, ComTxIPduUnusedAreasDefault=0
            ComTxModeTrue_ComTxIpdu_ComIPdu_ECU1_Msg_P3 (ComTxModeTrue): category=TOOL_CONFIGURED
              ComTxMode_ComTxModeTrue_ComTxIpdu_ComIPdu_ECU1_Msg_P3 (ComTxMode): category=TOOL_CONFIGURED, ComTxModeMode=PERIODIC, ComTxModeTimeOffset=0.0, ComTxModeTimePeriod=0.2
        ComIPdu_ECU1_Msg_P4: ComIPduDirection=SEND, ComIPduHandleId=10, ComIPduType=NORMAL, ComPduIdRef=Pdu_ISignalIPdu_ECU1_Msg_P4, ComIPduGroupRef=ComIPduGroupTx_ECU1_Project, ComIPduSignalRef=ComISignal_ECU1_Msg_P4_ECU1_Msg_P4_Sig2, ComIPduSignalRef=ComISignal_ECU1_Msg_P4_ECU1_Msg_P4_Sig1
          ComTxIpdu_ComIPdu_ECU1_Msg_P4 (ComTxIPdu): category=TOOL_CONFIGURED, ComMinimumDelayTime=0.02, ComTxIPduUnusedAreasDefault=0
            ComTxModeTrue_ComTxIpdu_ComIPdu_ECU1_Msg_P4 (ComTxModeTrue): category=TOOL_CONFIGURED
              ComTxMode_ComTxModeTrue_ComTxIpdu_ComIPdu_ECU1_Msg_P4 (ComTxMode): category=TOOL_CONFIGURED, ComTxModeMode=PERIODIC, ComTxModeTimeOffset=0.0, ComTxModeTimePeriod=0.2
        ComIPdu_ECU1_Msg_PIF1: ComIPduDirection=SEND, ComIPduHandleId=9, ComIPduType=NORMAL, ComPduIdRef=Pdu_ISignalIPdu_ECU1_Msg_PIF1, ComIPduGroupRef=ComIPduGroupTx_ECU1_Project, ComIPduSignalRef=ComISignal_ECU1_Msg_PIF1_ECU1_Msg_PIF1_Sig2, ComIPduSignalRef=ComISignal_ECU1_Msg_PIF1_ECU1_Msg_PIF1_Sig1
          ComTxIpdu_ComIPdu_ECU1_Msg_PIF1 (ComTxIPdu): category=TOOL_CONFIGURED, ComMinimumDelayTime=0.02, ComTxIPduUnusedAreasDefault=0
            ComTxModeTrue_ComTxIpdu_ComIPdu_ECU1_Msg_PIF1 (ComTxModeTrue): category=TOOL_CONFIGURED
              ComTxMode_ComTxModeTrue_ComTxIpdu_ComIPdu_ECU1_Msg_PIF1 (ComTxMode):
                category = TOOL_CONFIGURED
                ComTxModeMode = MIXED
                ComTxModeNumberOfRepetitions = 3
                ComTxModeRepetitionPeriod = 0.2
                ComTxModeTimeOffset = 0.0
                ComTxModeTimePeriod = 0.5
        ComIPdu_ECU1_Msg_POE1: ComIPduDirection=SEND, ComIPduHandleId=14, ComIPduType=NORMAL, ComPduIdRef=Pdu_ISignalIPdu_ECU1_Msg_POE1, ComIPduGroupRef=ComIPduGroupTx_ECU1_Project, ComIPduSignalRef=ComISignal_ECU1_Msg_POE1_ECU1_Msg_POE1_Sig2, ComIPduSignalRef=ComISignal_ECU1_Msg_POE1_ECU1_Msg_POE1_Sig1
          ComTxIpdu_ComIPdu_ECU1_Msg_POE1 (ComTxIPdu): category=TOOL_CONFIGURED, ComMinimumDelayTime=0.02, ComTxIPduUnusedAreasDefault=0
            ComTxModeTrue_ComTxIpdu_ComIPdu_ECU1_Msg_POE1 (ComTxModeTrue): category=TOOL_CONFIGURED
              ComTxMode_ComTxModeTrue_ComTxIpdu_ComIPdu_ECU1_Msg_POE1 (ComTxMode):
                category = TOOL_CONFIGURED
                ComTxModeMode = MIXED
                ComTxModeNumberOfRepetitions = 3
                ComTxModeRepetitionPeriod = 0.04
                ComTxModeTimeOffset = 0.0
                ComTxModeTimePeriod = 0.2
        ComIPdu_ECU1_Msg_POE2: ComIPduDirection=SEND, ComIPduHandleId=13, ComIPduType=NORMAL, ComPduIdRef=Pdu_ISignalIPdu_ECU1_Msg_POE2, ComIPduGroupRef=ComIPduGroupTx_ECU1_Project, ComIPduSignalRef=ComISignal_ECU1_Msg_POE2_ECU1_Msg_POE2_Sig2, ComIPduSignalRef=ComISignal_ECU1_Msg_POE2_ECU1_Msg_POE2_Sig1
          ComTxIpdu_ComIPdu_ECU1_Msg_POE2 (ComTxIPdu): category=TOOL_CONFIGURED, ComMinimumDelayTime=0.02, ComTxIPduUnusedAreasDefault=0
            ComTxModeTrue_ComTxIpdu_ComIPdu_ECU1_Msg_POE2 (ComTxModeTrue): category=TOOL_CONFIGURED
              ComTxMode_ComTxModeTrue_ComTxIpdu_ComIPdu_ECU1_Msg_POE2 (ComTxMode):
                category = TOOL_CONFIGURED
                ComTxModeMode = MIXED
                ComTxModeNumberOfRepetitions = 3
                ComTxModeRepetitionPeriod = 0.04
                ComTxModeTimeOffset = 0.0
                ComTxModeTimePeriod = 0.2
        ComIPdu_ECU1_Msg_POE3: ComIPduDirection=SEND, ComIPduHandleId=15, ComIPduType=NORMAL, ComPduIdRef=Pdu_ISignalIPdu_ECU1_Msg_POE3, ComIPduGroupRef=ComIPduGroupTx_ECU1_Project, ComIPduSignalRef=ComISignal_ECU1_Msg_POE3_ECU1_Msg_POE3_Sig2, ComIPduSignalRef=ComISignal_ECU1_Msg_POE3_ECU1_Msg_POE3_Sig1
          ComTxIpdu_ComIPdu_ECU1_Msg_POE3 (ComTxIPdu): category=TOOL_CONFIGURED, ComMinimumDelayTime=0.02, ComTxIPduUnusedAreasDefault=0
            ComTxModeTrue_ComTxIpdu_ComIPdu_ECU1_Msg_POE3 (ComTxModeTrue): category=TOOL_CONFIGURED
              ComTxMode_ComTxModeTrue_ComTxIpdu_ComIPdu_ECU1_Msg_POE3 (ComTxMode):
                category = TOOL_CONFIGURED
                ComTxModeMode = MIXED
                ComTxModeNumberOfRepetitions = 3
                ComTxModeRepetitionPeriod = 0.04
                ComTxModeTimeOffset = 0.0
                ComTxModeTimePeriod = 0.2
        ComIPdu_ECU1_Msg_TP1: ComIPduDirection=SEND, ComIPduHandleId=0, ComIPduType=TP, ComPduIdRef=Pdu_ISignalIPdu_ECU1_Msg_TP1, ComIPduGroupRef=ComIPduGroupTx_ECU1_Project, ComIPduSignalRef=ComISignal_ECU1_Msg_TP1_ECU1_Msg_TP1_signal
          ComTxIpdu_ComIPdu_ECU1_Msg_TP1 (ComTxIPdu): category=TOOL_CONFIGURED, ComMinimumDelayTime=0.0, ComTxIPduUnusedAreasDefault=0
            ComTxModeTrue_ComTxIpdu_ComIPdu_ECU1_Msg_TP1 (ComTxModeTrue): category=TOOL_CONFIGURED
              ComTxMode_ComTxModeTrue_ComTxIpdu_ComIPdu_ECU1_Msg_TP1 (ComTxMode): category=TOOL_CONFIGURED, ComTxModeMode=DIRECT, ComTxModeNumberOfRepetitions=0, ComTxModeRepetitionPeriod=0.0
        ComIPdu_ECU1_Msg_TP2: ComIPduDirection=SEND, ComIPduHandleId=1, ComIPduType=TP, ComPduIdRef=Pdu_ISignalIPdu_ECU1_Msg_TP2, ComIPduGroupRef=ComIPduGroupTx_ECU1_Project, ComIPduSignalRef=ComISignal_ECU1_Msg_TP2_ECU1_Msg_TP2_signal
          ComTxIpdu_ComIPdu_ECU1_Msg_TP2 (ComTxIPdu): category=TOOL_CONFIGURED, ComMinimumDelayTime=0.0, ComTxIPduUnusedAreasDefault=0
            ComTxModeTrue_ComTxIpdu_ComIPdu_ECU1_Msg_TP2 (ComTxModeTrue): category=TOOL_CONFIGURED
              ComTxMode_ComTxModeTrue_ComTxIpdu_ComIPdu_ECU1_Msg_TP2 (ComTxMode): category=TOOL_CONFIGURED, ComTxModeMode=DIRECT, ComTxModeNumberOfRepetitions=0, ComTxModeRepetitionPeriod=0.0
        ComIPdu_ECU2_Msg_OE1: ComIPduDirection=RECEIVE, ComIPduHandleId=0, ComIPduType=NORMAL, ComPduIdRef=Pdu_ISignalIPdu_ECU2_Msg_OE1, ComIPduGroupRef=ComIPduGroupRx_ECU1_Project, ComIPduSignalRef=ComISignal_ECU2_Msg_OE1_ECU2_Msg_OE1_Sig2, ComIPduSignalRef=ComISignal_ECU2_Msg_OE1_ECU2_Msg_OE1_Sig1
        ComIPdu_ECU2_Msg_P1: ComIPduDirection=RECEIVE, ComIPduHandleId=1, ComIPduType=NORMAL, ComPduIdRef=Pdu_ISignalIPdu_ECU2_Msg_P1, ComIPduGroupRef=ComIPduGroupRx_ECU1_Project, ComIPduSignalRef=ComISignal_ECU2_Msg_P1_ECU2_Msg_P1_Sig2, ComIPduSignalRef=ComISignal_ECU2_Msg_P1_ECU2_Msg_P1_Sig1
        ComIPdu_ECU2_Msg_PIF1: ComIPduDirection=RECEIVE, ComIPduHandleId=2, ComIPduType=NORMAL, ComPduIdRef=Pdu_ISignalIPdu_ECU2_Msg_PIF1, ComIPduGroupRef=ComIPduGroupRx_ECU1_Project, ComIPduSignalRef=ComISignal_ECU2_Msg_PIF1_ECU2_Msg_PIF1_Sig2, ComIPduSignalRef=ComISignal_ECU2_Msg_PIF1_ECU2_Msg_PIF1_Sig1
        ComIPdu_ECU2_Msg_POE1: ComIPduDirection=RECEIVE, ComIPduHandleId=3, ComIPduType=NORMAL, ComPduIdRef=Pdu_ISignalIPdu_ECU2_Msg_POE1, ComIPduGroupRef=ComIPduGroupRx_ECU1_Project, ComIPduSignalRef=ComISignal_ECU2_Msg_POE1_ECU2_Msg_POE1_Sig1, ComIPduSignalRef=ComISignal_ECU2_Msg_POE1_ECU2_Msg_POE1_Sig2
        ComIPdu_GST_Msg_TP1: ComIPduDirection=RECEIVE, ComIPduHandleId=4, ComIPduType=TP, ComPduIdRef=Pdu_ISignalIPdu_GST_Msg_TP1, ComIPduGroupRef=ComIPduGroupRx_ECU1_Project, ComIPduSignalRef=ComISignal_GST_Msg_TP1_GST_Msg_TP1_signal
        ComIPdu_GST_Msg_TP2: ComIPduDirection=RECEIVE, ComIPduHandleId=5, ComIPduType=TP, ComPduIdRef=Pdu_ISignalIPdu_GST_Msg_TP2, ComIPduGroupRef=ComIPduGroupRx_ECU1_Project, ComIPduSignalRef=ComISignal_GST_Msg_TP2_GST_Msg_TP2_signal
      ComIPduGroupRx_ECU1_Project (ComIPduGroup): category=TOOL_CONFIGURED, ComIPduGroupHandleId=0
      ComIPduGroupTx_ECU1_Project (ComIPduGroup): category=TOOL_CONFIGURED, ComIPduGroupHandleId=1
      35 x ComSignal, all with category=TOOL_CONFIGURED, ComSignalInitValue=0, ComSignalLength=1, ComSignalType=UINT8, ComTimeout=0.7, ComSigReportIdsMEnable=0:
        ComISignal_ECU1_Msg_GW1_ECU1_Msg_GW1_Sig2: ComBitPosition=15, ComBitSize=8, ComHandleId=8, ComSignalEndianness=BIG_ENDIAN, ComTransferProperty=TRIGGERED, ComSystemTemplateSystemSignalRef=ECU1_Msg_GW1_Sig2
        ComISignal_ECU1_Msg_GW1_ECU1_Msg_GW1_Sig1: ComBitPosition=7, ComBitSize=8, ComHandleId=9, ComSignalEndianness=BIG_ENDIAN, ComTransferProperty=TRIGGERED, ComSystemTemplateSystemSignalRef=ECU1_Msg_GW1_Sig1
        ComISignal_ECU1_Msg_IF1_ECU1_Msg_IF1_Sig2: ComBitPosition=15, ComBitSize=8, ComHandleId=6, ComSignalEndianness=BIG_ENDIAN, ComTransferProperty=TRIGGERED, ComSystemTemplateSystemSignalRef=ECU1_Msg_IF1_Sig2
        ComISignal_ECU1_Msg_IF1_ECU1_Msg_IF1_Sig1: ComBitPosition=7, ComBitSize=8, ComHandleId=7, ComSignalEndianness=BIG_ENDIAN, ComTransferProperty=TRIGGERED, ComSystemTemplateSystemSignalRef=ECU1_Msg_IF1_Sig1
        ComISignal_ECU1_Msg_OE1_ECU1_Msg_OE1_Sig2: ComBitPosition=12, ComBitSize=8, ComHandleId=15, ComSignalEndianness=LITTLE_ENDIAN, ComTransferProperty=TRIGGERED_ON_CHANGE_WITHOUT_REPETITION, ComSystemTemplateSystemSignalRef=ECU1_Msg_OE1_Sig2
        ComISignal_ECU1_Msg_OE1_ECU1_Msg_OE1_Sig1: ComBitPosition=7, ComBitSize=8, ComHandleId=16, ComSignalEndianness=BIG_ENDIAN, ComTransferProperty=TRIGGERED_WITHOUT_REPETITION, ComSystemTemplateSystemSignalRef=ECU1_Msg_OE1_Sig1
        ComISignal_ECU1_Msg_OE2_ECU1_Msg_OE2_Sig5: ComBitPosition=35, ComBitSize=4, ComHandleId=10, ComSignalEndianness=BIG_ENDIAN, ComTransferProperty=TRIGGERED_ON_CHANGE, ComSystemTemplateSystemSignalRef=ECU1_Msg_OE2_Sig5
        ComISignal_ECU1_Msg_OE2_ECU1_Msg_OE2_Sig4: ComBitPosition=26, ComBitSize=3, ComHandleId=11, ComSignalEndianness=BIG_ENDIAN, ComTransferProperty=TRIGGERED_ON_CHANGE, ComSystemTemplateSystemSignalRef=ECU1_Msg_OE2_Sig4
        ComISignal_ECU1_Msg_OE2_ECU1_Msg_OE2_Sig3: ComBitPosition=17, ComBitSize=2, ComHandleId=12, ComSignalEndianness=BIG_ENDIAN, ComTransferProperty=TRIGGERED_ON_CHANGE, ComSystemTemplateSystemSignalRef=ECU1_Msg_OE2_Sig3
        ComISignal_ECU1_Msg_OE2_ECU1_Msg_OE2_Sig2: ComBitPosition=11, ComBitSize=8, ComHandleId=13, ComSignalEndianness=BIG_ENDIAN, ComTransferProperty=TRIGGERED_ON_CHANGE, ComSystemTemplateSystemSignalRef=ECU1_Msg_OE2_Sig2
        ComISignal_ECU1_Msg_OE2_ECU1_Msg_OE2_Sig1: ComBitPosition=7, ComBitSize=8, ComHandleId=14, ComSignalEndianness=BIG_ENDIAN, ComTransferProperty=TRIGGERED, ComSystemTemplateSystemSignalRef=ECU1_Msg_OE2_Sig1
        ComISignal_ECU1_Msg_P1_ECU1_Msg_P1_Sig2: ComBitPosition=15, ComBitSize=8, ComHandleId=17, ComSignalEndianness=BIG_ENDIAN, ComTransferProperty=PENDING, ComSystemTemplateSystemSignalRef=ECU1_Msg_P1_Sig2
        ComISignal_ECU1_Msg_P1_ECU1_Msg_P1_Sig1: ComBitPosition=7, ComBitSize=8, ComHandleId=18, ComSignalEndianness=BIG_ENDIAN, ComTransferProperty=PENDING, ComSystemTemplateSystemSignalRef=ECU1_Msg_P1_Sig1
        ComISignal_ECU1_Msg_P2_ECU1_Msg_P2_Sig2: ComBitPosition=15, ComBitSize=8, ComHandleId=25, ComSignalEndianness=BIG_ENDIAN, ComTransferProperty=PENDING, ComSystemTemplateSystemSignalRef=ECU1_Msg_P2_Sig2
        ComISignal_ECU1_Msg_P2_ECU1_Msg_P2_Sig1: ComBitPosition=7, ComBitSize=8, ComHandleId=26, ComSignalEndianness=BIG_ENDIAN, ComTransferProperty=PENDING, ComSystemTemplateSystemSignalRef=ECU1_Msg_P2_Sig1
        ComISignal_ECU1_Msg_P3_ECU1_Msg_P3_Sig2: ComBitPosition=15, ComBitSize=8, ComHandleId=23, ComSignalEndianness=BIG_ENDIAN, ComTransferProperty=PENDING, ComSystemTemplateSystemSignalRef=ECU1_Msg_P3_Sig2
        ComISignal_ECU1_Msg_P3_ECU1_Msg_P3_Sig1: ComBitPosition=7, ComBitSize=8, ComHandleId=24, ComSignalEndianness=BIG_ENDIAN, ComTransferProperty=PENDING, ComSystemTemplateSystemSignalRef=ECU1_Msg_P3_Sig1
        ComISignal_ECU1_Msg_P4_ECU1_Msg_P4_Sig2: ComBitPosition=15, ComBitSize=8, ComHandleId=21, ComSignalEndianness=BIG_ENDIAN, ComTransferProperty=PENDING, ComSystemTemplateSystemSignalRef=ECU1_Msg_P4_Sig2
        ComISignal_ECU1_Msg_P4_ECU1_Msg_P4_Sig1: ComBitPosition=7, ComBitSize=8, ComHandleId=22, ComSignalEndianness=BIG_ENDIAN, ComTransferProperty=PENDING, ComSystemTemplateSystemSignalRef=ECU1_Msg_P4_Sig1
        ComISignal_ECU1_Msg_PIF1_ECU1_Msg_PIF1_Sig2: ComBitPosition=15, ComBitSize=8, ComHandleId=19, ComSignalEndianness=BIG_ENDIAN, ComTransferProperty=TRIGGERED, ComSystemTemplateSystemSignalRef=ECU1_Msg_PIF1_Sig2
        ComISignal_ECU1_Msg_PIF1_ECU1_Msg_PIF1_Sig1: ComBitPosition=7, ComBitSize=8, ComHandleId=20, ComSignalEndianness=BIG_ENDIAN, ComTransferProperty=TRIGGERED, ComSystemTemplateSystemSignalRef=ECU1_Msg_PIF1_Sig1
        ComISignal_ECU1_Msg_POE1_ECU1_Msg_POE1_Sig2: ComBitPosition=15, ComBitSize=8, ComHandleId=29, ComSignalEndianness=BIG_ENDIAN, ComTransferProperty=TRIGGERED_ON_CHANGE_WITHOUT_REPETITION, ComSystemTemplateSystemSignalRef=ECU1_Msg_POE1_Sig2
        ComISignal_ECU1_Msg_POE1_ECU1_Msg_POE1_Sig1: ComBitPosition=7, ComBitSize=8, ComHandleId=30, ComSignalEndianness=BIG_ENDIAN, ComTransferProperty=TRIGGERED_WITHOUT_REPETITION, ComSystemTemplateSystemSignalRef=ECU1_Msg_POE1_Sig1
        ComISignal_ECU1_Msg_POE2_ECU1_Msg_POE2_Sig2: ComBitPosition=15, ComBitSize=8, ComHandleId=27, ComSignalEndianness=BIG_ENDIAN, ComTransferProperty=TRIGGERED_ON_CHANGE, ComSystemTemplateSystemSignalRef=ECU1_Msg_POE2_Sig2
        ComISignal_ECU1_Msg_POE2_ECU1_Msg_POE2_Sig1: ComBitPosition=7, ComBitSize=8, ComHandleId=28, ComSignalEndianness=BIG_ENDIAN, ComTransferProperty=TRIGGERED, ComSystemTemplateSystemSignalRef=ECU1_Msg_POE2_Sig1
        ComISignal_ECU1_Msg_POE3_ECU1_Msg_POE3_Sig2: ComBitPosition=15, ComBitSize=8, ComHandleId=31, ComSignalEndianness=BIG_ENDIAN, ComTransferProperty=TRIGGERED_ON_CHANGE_WITHOUT_REPETITION, ComSystemTemplateSystemSignalRef=ECU1_Msg_POE3_Sig2
        ComISignal_ECU1_Msg_POE3_ECU1_Msg_POE3_Sig1: ComBitPosition=7, ComBitSize=8, ComHandleId=32, ComSignalEndianness=BIG_ENDIAN, ComTransferProperty=TRIGGERED_WITHOUT_REPETITION, ComSystemTemplateSystemSignalRef=ECU1_Msg_POE3_Sig1
        ComISignal_ECU2_Msg_OE1_ECU2_Msg_OE1_Sig2: ComBitPosition=15, ComBitSize=8, ComHandleId=0, ComSignalEndianness=BIG_ENDIAN, ComTransferProperty=TRIGGERED_WITHOUT_REPETITION, ComSystemTemplateSystemSignalRef=ECU2_Msg_OE1_Sig2
        ComISignal_ECU2_Msg_OE1_ECU2_Msg_OE1_Sig1: ComBitPosition=7, ComBitSize=8, ComHandleId=1, ComSignalEndianness=BIG_ENDIAN, ComTransferProperty=TRIGGERED_WITHOUT_REPETITION, ComSystemTemplateSystemSignalRef=ECU2_Msg_OE1_Sig1
        ComISignal_ECU2_Msg_P1_ECU2_Msg_P1_Sig2: ComBitPosition=15, ComBitSize=8, ComHandleId=2, ComSignalEndianness=BIG_ENDIAN, ComTransferProperty=PENDING, ComSystemTemplateSystemSignalRef=ECU2_Msg_P1_Sig2
        ComISignal_ECU2_Msg_P1_ECU2_Msg_P1_Sig1: ComBitPosition=7, ComBitSize=8, ComHandleId=3, ComSignalEndianness=BIG_ENDIAN, ComTransferProperty=PENDING, ComSystemTemplateSystemSignalRef=ECU2_Msg_P1_Sig1
        ComISignal_ECU2_Msg_PIF1_ECU2_Msg_PIF1_Sig2: ComBitPosition=31, ComBitSize=8, ComHandleId=4, ComSignalEndianness=BIG_ENDIAN, ComTransferProperty=TRIGGERED, ComSystemTemplateSystemSignalRef=ECU2_Msg_PIF1_Sig2
        ComISignal_ECU2_Msg_PIF1_ECU2_Msg_PIF1_Sig1: ComBitPosition=23, ComBitSize=8, ComHandleId=5, ComSignalEndianness=BIG_ENDIAN, ComTransferProperty=TRIGGERED, ComSystemTemplateSystemSignalRef=ECU2_Msg_PIF1_Sig1
        ComISignal_ECU2_Msg_POE1_ECU2_Msg_POE1_Sig1: ComBitPosition=31, ComBitSize=8, ComHandleId=6, ComSignalEndianness=BIG_ENDIAN, ComTransferProperty=TRIGGERED, ComSystemTemplateSystemSignalRef=ECU2_Msg_POE1_Sig1
        ComISignal_ECU2_Msg_POE1_ECU2_Msg_POE1_Sig2: ComBitPosition=23, ComBitSize=8, ComHandleId=7, ComSignalEndianness=BIG_ENDIAN, ComTransferProperty=TRIGGERED_ON_CHANGE, ComSystemTemplateSystemSignalRef=ECU2_Msg_POE1_Sig2
      ComTimeBase: category=TOOL_CONFIGURED, ComGwTimeBase=0.005, ComRxTimeBase=0.005, ComTxTimeBase=0.005
      4 x ComSignal, all with category=TOOL_CONFIGURED, ComBitPosition=0, ComBitSize=64, ComSignalEndianness=opaque, ComSignalLength=8, ComSignalType=UINT8_N, ComTransferProperty=TRIGGERED_WITHOUT_REPETITION, ComSignalInitValue=0 0 0 0 0 0 0 0, ComSigReportIdsMEnable=0:
        ComISignal_ECU1_Msg_TP1_ECU1_Msg_TP1_signal: ComHandleId=0, ComSystemTemplateSystemSignalRef=ECU1_Msg_TP1_signal
        ComISignal_ECU1_Msg_TP2_ECU1_Msg_TP2_signal: ComHandleId=1, ComSystemTemplateSystemSignalRef=ECU1_Msg_TP2_signal
        ComISignal_GST_Msg_TP1_GST_Msg_TP1_signal: ComHandleId=8, ComTimeout=0.7, ComSystemTemplateSystemSignalRef=GST_Msg_TP1_signal
        ComISignal_GST_Msg_TP2_GST_Msg_TP2_signal: ComHandleId=9, ComTimeout=0.7, ComSystemTemplateSystemSignalRef=GST_Msg_TP2_signal
      5 x ComIPdu, all with category=TOOL_CONFIGURED, ComIPduType=NORMAL, ComIPduSignalProcessing=DEFERRED:
        ComIPdu_CC_Recv1: ComIPduDirection=RECEIVE, ComIPduHandleId=6, ComIPduGroupRef=ComIPduGroupRx_ECU1_Project, ComIPduSignalRef=ComISignal_CC_Recv1_ACCEL_VALUE, ComIPduSignalRef=ComISignal_CC_Recv1_TARGET_SPEED, ComPduIdRef=Pdu_ISignalIPdu_CC_Recv1
        ComIPdu_CC_Recv2: ComIPduDirection=RECEIVE, ComIPduHandleId=7, ComIPduGroupRef=ComIPduGroupRx_ECU1_Project, ComIPduSignalRef=ComISignal_CC_Recv2_SPEED, ComIPduSignalRef=ComISignal_CC_Recv2_CC_TRIGGER, ComPduIdRef=Pdu_ISignalIPdu_CC_Recv2
        ComIPdu_CC_Send: ComIPduDirection=SEND, ComIPduHandleId=2, ComIPduGroupRef=ComIPduGroupTx_ECU1_Project, ComIPduSignalRef=ComISignal_CC_Send_BRAKE, ComIPduSignalRef=ComISignal_CC_Send_ACCEL, ComPduIdRef=Pdu_ISignalIPdu_CC_Send
          ComTxIpdu_ComIPdu_CC_Send (ComTxIPdu): category=TOOL_CONFIGURED, ComTxIPduUnusedAreasDefault=0, ComMinimumDelayTime=0.02
            ComTxModeTrue_ComTxIpdu_ComIPdu_CC_Send (ComTxModeTrue): category=TOOL_CONFIGURED
              ComTxMode_ComTxModeTrue_ComTxIpdu_ComIPdu_CC_Send (ComTxMode): category=TOOL_CONFIGURED, ComTxModeNumberOfRepetitions=3, ComTxModeRepetitionPeriod=0.04, ComTxModeMode=DIRECT
        ComIPdu_LKAS_Recv: ComIPduDirection=RECEIVE, ComIPduHandleId=8, ComIPduGroupRef=ComIPduGroupRx_ECU1_Project, ComIPduSignalRef=ComISignal_LKAS_Recv_STEER_VALUE, ComIPduSignalRef=ComISignal_LKAS_Recv_LKAS_TRIGGER, ComPduIdRef=Pdu_ISignalIPdu_LKAS_Recv
        ComIPdu_LKAS_Send: ComIPduDirection=SEND, ComIPduHandleId=3, ComIPduGroupRef=ComIPduGroupTx_ECU1_Project, ComIPduSignalRef=ComISignal_LKAS_Send_RIGHT_STEER, ComIPduSignalRef=ComISignal_LKAS_Send_LEFT_STEER, ComPduIdRef=Pdu_ISignalIPdu_LKAS_Send
          ComTxIpdu_ComIPdu_LKAS_Send (ComTxIPdu): category=TOOL_CONFIGURED, ComTxIPduUnusedAreasDefault=0, ComMinimumDelayTime=0.02
            ComTxModeTrue_ComTxIpdu_ComIPdu_LKAS_Send (ComTxModeTrue): category=TOOL_CONFIGURED
              ComTxMode_ComTxModeTrue_ComTxIpdu_ComIPdu_LKAS_Send (ComTxMode): category=TOOL_CONFIGURED, ComTxModeNumberOfRepetitions=3, ComTxModeRepetitionPeriod=0.04, ComTxModeMode=DIRECT
      10 x ComSignal, all with category=TOOL_CONFIGURED, ComBitSize=32, ComSignalEndianness=LITTLE_ENDIAN, ComSignalInitValue=0, ComSignalLength=4, ComSigReportIdsMEnable=0:
        ComISignal_CC_Recv1_ACCEL_VALUE: ComBitPosition=32, ComSignalType=UINT32, ComTransferProperty=TRIGGERED_ON_CHANGE_WITHOUT_REPETITION, ComHandleId=10, ComTimeout=0.7, ComNotification=Rte_COMCbk_ComISignal_CC_Recv1_ACCEL_VALUE, ComSystemTemplateSystemSignalRef=ACCEL_VALUE
        ComISignal_CC_Recv1_TARGET_SPEED: ComBitPosition=0, ComSignalType=SINT32, ComTransferProperty=TRIGGERED_ON_CHANGE_WITHOUT_REPETITION, ComHandleId=11, ComTimeout=0.7, ComNotification=Rte_COMCbk_ComISignal_CC_Recv1_TARGET_SPEED, ComSystemTemplateSystemSignalRef=TARGET_SPEED
        ComISignal_CC_Recv2_SPEED: ComBitPosition=32, ComSignalType=SINT32, ComTransferProperty=TRIGGERED_ON_CHANGE_WITHOUT_REPETITION, ComHandleId=12, ComTimeout=0.7, ComNotification=Rte_COMCbk_ComISignal_CC_Recv2_SPEED, ComSystemTemplateSystemSignalRef=SPEED
        ComISignal_CC_Recv2_CC_TRIGGER: ComBitPosition=0, ComSignalType=SINT32, ComTransferProperty=TRIGGERED_ON_CHANGE_WITHOUT_REPETITION, ComHandleId=13, ComTimeout=0.7, ComNotification=Rte_COMCbk_ComISignal_CC_Recv2_CC_TRIGGER, ComSystemTemplateSystemSignalRef=CC_TRIGGER
        ComISignal_CC_Send_BRAKE: ComBitPosition=32, ComSignalType=SINT32, ComTransferProperty=TRIGGERED_ON_CHANGE_WITHOUT_REPETITION, ComHandleId=2, ComSystemTemplateSystemSignalRef=BRAKE
        ComISignal_CC_Send_ACCEL: ComBitPosition=0, ComSignalType=SINT32, ComTransferProperty=TRIGGERED_WITHOUT_REPETITION, ComHandleId=3, ComSystemTemplateSystemSignalRef=ACCEL
        ComISignal_LKAS_Recv_STEER_VALUE: ComBitPosition=32, ComSignalType=SINT32, ComTransferProperty=TRIGGERED_ON_CHANGE_WITHOUT_REPETITION, ComHandleId=14, ComTimeout=0.7, ComNotification=Rte_COMCbk_ComISignal_LKAS_Recv_STEER_VALUE, ComSystemTemplateSystemSignalRef=STEER_VALUE
        ComISignal_LKAS_Recv_LKAS_TRIGGER: ComBitPosition=0, ComSignalType=SINT32, ComTransferProperty=TRIGGERED_ON_CHANGE_WITHOUT_REPETITION, ComHandleId=15, ComTimeout=0.7, ComNotification=Rte_COMCbk_ComISignal_LKAS_Recv_LKAS_TRIGGER, ComSystemTemplateSystemSignalRef=LKAS_TRIGGER
        ComISignal_LKAS_Send_RIGHT_STEER: ComBitPosition=32, ComSignalType=SINT32, ComTransferProperty=TRIGGERED_WITHOUT_REPETITION, ComHandleId=4, ComSystemTemplateSystemSignalRef=RIGHT_STEER
        ComISignal_LKAS_Send_LEFT_STEER: ComBitPosition=0, ComSignalType=SINT32, ComTransferProperty=TRIGGERED_WITHOUT_REPETITION, ComHandleId=5, ComSystemTemplateSystemSignalRef=LEFT_STEER
    ComGeneral:
      ComConfigurationUseDet = 1
      ComEnableMDTForCyclicTransmission = 1
      ComRetryFailedTransmitRequests = 0
      ComSupportedIPduGroups = 2
      ComVersionInfoApi = 0
      ComMainFunctionBasedTransmit = 1
      ComEnableSignalGroupArrayApi = false
