AUTOSAR XML (schema 4-0-3)
package /AUTOSAR
  module config EcuC: implementation-config-variant=VARIANT-POST-BUILD, module-description=BswImplementation_Can
    EcucPduCollection: PduIdTypeEnum=UINT8, PduLengthTypeEnum=UINT8
      35 x Pdu, all with category=TOOL_CONFIGURED:
        Pdu_DcmIPdu_ECU1_GST_Msg_TP: PduLength=8, SysTPduToFrameMappingRef=PduToFrame_ECU1_GST_Msg_TP
        Pdu_NPdu_ECU1_GST_Msg_TP: PduLength=8, SysTPduToFrameMappingRef=MapNPdu_ECU1_GST_Msg_TP
        Pdu_ISignalIPdu_ECU1_Msg_GW1: PduLength=8, SysTPduToFrameMappingRef=PduToFrame_ECU1_Msg_GW1
        Pdu_ISignalIPdu_ECU1_Msg_IF1: PduLength=8, SysTPduToFrameMappingRef=PduToFrame_ECU1_Msg_IF1
        Pdu_ISignalIPdu_ECU1_Msg_OE1: PduLength=8, SysTPduToFrameMappingRef=PduToFrame_ECU1_Msg_OE1
        Pdu_ISignalIPdu_ECU1_Msg_OE2: PduLength=8, SysTPduToFrameMappingRef=PduToFrame_ECU1_Msg_OE2
        Pdu_ISignalIPdu_ECU1_Msg_P{1..4}: PduLength=8, SysTPduToFrameMappingRef=PduToFrame_ECU1_Msg_P{1..4}
        Pdu_ISignalIPdu_ECU1_Msg_PIF1: PduLength=8, SysTPduToFrameMappingRef=PduToFrame_ECU1_Msg_PIF1
        Pdu_ISignalIPdu_ECU1_Msg_POE{1..3}: PduLength=8, SysTPduToFrameMappingRef=PduToFrame_ECU1_Msg_POE{1..3}
        Pdu_ISignalIPdu_ECU1_Msg_TP1: PduLength=8, SysTPduToFrameMappingRef=PduToFrame_ECU1_Msg_TP1
        Pdu_NPdu_ECU1_Msg_TP1: PduLength=8, SysTPduToFrameMappingRef=MapNPdu_ECU1_Msg_TP1
        Pdu_ISignalIPdu_ECU1_Msg_TP2: PduLength=8, SysTPduToFrameMappingRef=PduToFrame_ECU1_Msg_TP2
        Pdu_NPdu_ECU1_Msg_TP2: PduLength=8, SysTPduToFrameMappingRef=MapNPdu_ECU1_Msg_TP2
        Pdu_ISignalIPdu_ECU2_Msg_OE1: PduLength=8, SysTPduToFrameMappingRef=PduToFrame_ECU2_Msg_OE1
        Pdu_ISignalIPdu_ECU2_Msg_P1: PduLength=2, SysTPduToFrameMappingRef=PduToFrame_ECU2_Msg_P1
        Pdu_ISignalIPdu_ECU2_Msg_PIF1: PduLength=8, SysTPduToFrameMappingRef=PduToFrame_ECU2_Msg_PIF1
        Pdu_ISignalIPdu_ECU2_Msg_POE1: PduLength=8, SysTPduToFrameMappingRef=PduToFrame_ECU2_Msg_POE1
        Pdu_ISignalIPdu_GST_Msg_TP1: PduLength=8, SysTPduToFrameMappingRef=PduToFrame_GST_Msg_TP1
        Pdu_NPdu_GST_Msg_TP1: PduLength=8, SysTPduToFrameMappingRef=MapNPdu_GST_Msg_TP1
        Pdu_ISignalIPdu_GST_Msg_TP2: PduLength=8, SysTPduToFrameMappingRef=PduToFrame_GST_Msg_TP2
        Pdu_NPdu_GST_Msg_TP2: PduLength=8, SysTPduToFrameMappingRef=MapNPdu_GST_Msg_TP2
        Pdu_DcmIPdu_GST_Msg_TP_Func: PduLength=8, SysTPduToFrameMappingRef=PduToFrame_GST_Msg_TP_Func
        Pdu_NPdu_GST_Msg_TP_Func: PduLength=8, SysTPduToFrameMappingRef=MapNPdu_GST_Msg_TP_Func
        Pdu_DcmIPdu_GST_Msg_TP_Phys: PduLength=8, SysTPduToFrameMappingRef=PduToFrame_GST_Msg_TP_Phys
        Pdu_NPdu_GST_Msg_TP_Phys: PduLength=8, SysTPduToFrameMappingRef=MapNPdu_GST_Msg_TP_Phys
        Pdu_ISignalIPdu_CC_Recv1: PduLength=8, SysTPduToFrameMappingRef=PduToFrame_CC_Recv1
        Pdu_ISignalIPdu_CC_Recv2: PduLength=8, SysTPduToFrameMappingRef=PduToFrame_CC_Recv2
        Pdu_ISignalIPdu_CC_Send: PduLength=8, SysTPduToFrameMappingRef=PduToFrame_CC_Send
        Pdu_ISignalIPdu_LKAS_Recv: PduLength=8, SysTPduToFrameMappingRef=PduToFrame_LKAS_Recv
        Pdu_ISignalIPdu_LKAS_Send: PduLength=8, SysTPduToFrameMappingRef=PduToFrame_LKAS_Send
