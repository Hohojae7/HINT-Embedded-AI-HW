AUTOSAR XML (schema 4-0-3)
package /Can
  module config Can: implementation-config-variant=VARIANT-POST-BUILD, module-description=BswImplementation_Can
    NonAutosar: CanDisableDemReportErrorStatus=0, CanApiErrorStatus=0, CanApiCheckTxCancel=0
    CanConfigSet
      ECU1_Project (CanController):
        category = TOOL_CONFIGURED
        CanHwChannel = FlexCAN_B
        CanControllerActivation = 1
        CanControllerBaseAddress = 0
        CanControllerId = 0
        CanRxProcessing = Interrupt
        CanTxProcessing = Interrupt
        CanBusoffProcessing = Interrupt
        CanWakeupProcessing = Interrupt
        CanBccSupport = 0
        CanWakeupSupport = 0
        CanListenOnlyMode = 0
        CanLoopBackMode = 0
        CanSoftwareBusOffRecovery = 1
        CanAutoBusOffRecovery = 0
        CanTrippleSamplingEnable = 0
        CanWakeUpSourceFilter = 0
        CanLowestBuffTransmitFirst = 0
        CanLocalPriorityEn = 0
        CanWarningEnable = 0
        CanClockFromBus = 0
        CanControllerRxFifoEnable = 0
        CanRxFifoWarningNotification = NULL_PTR
        CanRxFifoOverflowNotification = NULL_PTR
        CanErrorControllerNotifEn = 0
        CanErrorControllerNotification = NULL_PTR
        CanControllerDefaultBaudrate = CanControllerBaudrateConfig
        CanControllerBaudrateConfig:
          category = TOOL_CONFIGURED
          CanControllerCheckCanStandard = 1
          CanAdvancedSetting = 0
          CanBusLength = 40
          CanPropDelayTranceiver = 150
          CanControllerPrescaller = 1
          CanControllerPrescaller_Alt = 1
          CanControllerBaudRate = 500
          CanControllerPropSeg = 2
          CanControllerSeg1 = 7
          CanControllerSeg2 = 3
          CanControllerSyncJumpWidth = 3
        DefaultFilterMask (CanFilterMask): category=TOOL_CONFIGURED, CanFilterMaskValue=2047
        DefaultExtFilterMask (CanFilterMask): category=TOOL_CONFIGURED, CanFilterMaskValue=536870911
      28 x CanHardwareObject, all with category=TOOL_CONFIGURED, CanHandleType=FULL, CanIdType=STANDARD, CanMBPrio=0, CanControllerRef=ECU1_Project:
        IN_HwObj_ECU1_Project_0x7df_GST_Msg_TP_Func: CanIdValue=2015, CanObjectId=7, CanObjectType=RECEIVE, CanFilterMaskRef=DefaultFilterMask
        IN_HwObj_ECU1_Project_0x707_GST_Msg_TP2: CanIdValue=1799, CanObjectId=6, CanObjectType=RECEIVE, CanFilterMaskRef=DefaultFilterMask
        IN_HwObj_ECU1_Project_0x706_GST_Msg_TP1: CanIdValue=1798, CanObjectId=5, CanObjectType=RECEIVE, CanFilterMaskRef=DefaultFilterMask
        IN_HwObj_ECU1_Project_0x703_GST_Msg_TP_Phys: CanIdValue=1795, CanObjectId=4, CanObjectType=RECEIVE, CanFilterMaskRef=DefaultFilterMask
        IN_HwObj_ECU1_Project_0x503_ECU2_Msg_P1: CanIdValue=1283, CanObjectId=3, CanObjectType=RECEIVE, CanFilterMaskRef=DefaultFilterMask
        IN_HwObj_ECU1_Project_0x301_ECU2_Msg_PIF1: CanIdValue=769, CanObjectId=2, CanObjectType=RECEIVE, CanFilterMaskRef=DefaultFilterMask
        IN_HwObj_ECU1_Project_0x103_ECU2_Msg_POE1: CanIdValue=259, CanObjectId=1, CanObjectType=RECEIVE, CanFilterMaskRef=DefaultFilterMask
        IN_HwObj_ECU1_Project_0x3_ECU2_Msg_OE1: CanIdValue=3, CanObjectId=0, CanObjectType=RECEIVE, CanFilterMaskRef=DefaultFilterMask
        OUT_HwObj_ECU1_Project_0x705_ECU1_GST_Msg_TP: CanIdValue=1797, CanObjectId=25, CanObjectType=TRANSMIT
        OUT_HwObj_ECU1_Project_0x704_ECU1_Msg_TP2: CanIdValue=1796, CanObjectId=24, CanObjectType=TRANSMIT
        OUT_HwObj_ECU1_Project_0x701_ECU1_Msg_TP1: CanIdValue=1793, CanObjectId=23, CanObjectType=TRANSMIT
        OUT_HwObj_ECU1_Project_0x602_ECU1_Msg_P4: CanIdValue=1538, CanObjectId=22, CanObjectType=TRANSMIT
        OUT_HwObj_ECU1_Project_0x601_ECU1_Msg_P3: CanIdValue=1537, CanObjectId=21, CanObjectType=TRANSMIT
        OUT_HwObj_ECU1_Project_0x502_ECU1_Msg_P2: CanIdValue=1282, CanObjectId=19, CanObjectType=TRANSMIT
        OUT_HwObj_ECU1_Project_0x501_ECU1_Msg_P1: CanIdValue=1281, CanObjectId=18, CanObjectType=TRANSMIT
        OUT_HwObj_ECU1_Project_0x300_ECU1_Msg_PIF1: CanIdValue=768, CanObjectId=17, CanObjectType=TRANSMIT
        OUT_HwObj_ECU1_Project_0x200_ECU1_Msg_IF1: CanIdValue=512, CanObjectId=15, CanObjectType=TRANSMIT
        OUT_HwObj_ECU1_Project_0x102_ECU1_Msg_POE2: CanIdValue=258, CanObjectId=13, CanObjectType=TRANSMIT
        OUT_HwObj_ECU1_Project_0x101_ECU1_Msg_POE1: CanIdValue=257, CanObjectId=12, CanObjectType=TRANSMIT
        OUT_HwObj_ECU1_Project_0x100_ECU1_Msg_POE3: CanIdValue=256, CanObjectId=11, CanObjectType=TRANSMIT
        OUT_HwObj_ECU1_Project_0x55_ECU1_Msg_GW1: CanIdValue=85, CanObjectId=20, CanObjectType=TRANSMIT
        OUT_HwObj_ECU1_Project_0x2_ECU1_Msg_OE2: CanIdValue=2, CanObjectId=16, CanObjectType=TRANSMIT
        OUT_HwObj_ECU1_Project_0x1_ECU1_Msg_OE1: CanIdValue=1, CanObjectId=14, CanObjectType=TRANSMIT
        IN_HwObj_ECU1_Project_0x7fd_CC_Recv2: CanIdValue=2045, CanObjectType=RECEIVE, CanObjectId=10, CanFilterMaskRef=DefaultFilterMask
        IN_HwObj_ECU1_Project_0x7fc_LKAS_Recv: CanIdValue=2044, CanObjectType=RECEIVE, CanObjectId=9, CanFilterMaskRef=DefaultFilterMask
        IN_HwObj_ECU1_Project_0x7ef_CC_Recv1: CanIdValue=2031, CanObjectType=RECEIVE, CanObjectId=8, CanFilterMaskRef=DefaultFilterMask
        OUT_HwObj_ECU1_Project_0x7ff_CC_Send: CanIdValue=2047, CanObjectType=TRANSMIT, CanObjectId=27
        OUT_HwObj_ECU1_Project_0x7fe_LKAS_Send: CanIdValue=2046, CanObjectType=TRANSMIT, CanObjectId=26
    CanGeneral:
      CanChangeBaudrateApi = 0
      CanDevErrorDetection = 1
      CanVersionInfoApi = 0
      CanIndex = 0
      CanMainFunctionBusoffPeriod = 0.0010
      CanMainFunctionWakeupPeriod = 0.0010
      CanMainFunctionModePeriod = 0.001
      CanMultiplexedTransmission = 0
      CanHardwareCancellation = 0
      CanIdenticalIdCancellation = 0
      CanTimeoutDuration = 20000
      CanCrystalFrequencyHz = 8000000
      CanCodeSizeOptimization = 0
      CanExtendedIDSupport = 0
      CanMBCountExtensionSupport = 0
      CanApiEnableMbAbort = 0
      CanAbortOnlyOneMB = 0
      CanEnableDualClockMode = 0
      CanCounterRef = OsCounter_0
      CanMainFunctionRWPeriods: category=TOOL_CONFIGURED
        CanMainFunctionReadPeriod_0 (CanMainFunctionReadPeriod): CanMainFunctionReadPeriod=0.0010
        CanMainFunctionWritePeriod_0 (CanMainFunctionWritePeriod): CanMainFunctionWritePeriod=0.0010
    CommonPublishedInformation:
      ArReleaseMajorVersion = 4
      ArReleaseMinorVersion = 0
      ArReleaseRevisionVersion = 3
      ModuleId = 80
      SwMajorVersion = 1
      SwMinorVersion = 0
      VendorId = 43
      SwPatchVersion = 1
