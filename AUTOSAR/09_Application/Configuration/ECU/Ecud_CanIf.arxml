AUTOSAR XML (schema 4-0-3)
package /AUTOSAR
  module config CanIf: implementation-config-variant=VARIANT-PRE-COMPILE, module-description=BswImplementation_CanIf
    CanIfCtrlDrvCfg: CanIfCtrlDrvTxCancellation=0, CanIfCtrlDrvInitHohConfigRef=CanIfInitHohCfg, CanIfCtrlDrvNameRef=CanGeneral
      CanIfCtrlCfg_ECU1_Project (CanIfCtrlCfg): category=TOOL_CONFIGURED, CanIfCtrlId=0, CanIfCtrlWakeupSupport=0, CanIfCtrlCanCtrlRef=ECU1_Project
    CanIfDispatchCfg:
      CanIfDispatchUserCheckTrcvWakeFlagIndicationUL = CAN_SM
      CanIfDispatchUserClearTrcvWufFlagIndicationUL = CAN_SM
      CanIfDispatchUserConfirmPnAvailabilityUL = CAN_SM
      CanIfDispatchUserCtrlBusOffUL = CAN_SM
      CanIfDispatchUserCtrlModeIndicationUL = CAN_SM
      CanIfDispatchUserTrcvModeIndicationUL = CAN_SM
      CanIfDispatchUserValidateWakeupEventUL = ECUM
      CanIfDispatchUserConfirmPnAvailabilityName = 
    CanIfInitCfg: CanIfInitCfgSet=
      15 x CanIfBufferCfg, all with category=TOOL_CONFIGURED, CanIfBufferSize=0:
        CanIfBufferCfg_OUT_ECU1_Project_0x705_ECU1_GST_Msg_TP: CanIfBufferHthRef=CanIfHthCfg_OUT_ECU1_Project_0x705_ECU1_GST_Msg_TP
        CanIfBufferCfg_OUT_ECU1_Project_0x704_ECU1_Msg_TP2: CanIfBufferHthRef=CanIfHthCfg_OUT_ECU1_Project_0x704_ECU1_Msg_TP2
        CanIfBufferCfg_OUT_ECU1_Project_0x701_ECU1_Msg_TP1: CanIfBufferHthRef=CanIfHthCfg_OUT_ECU1_Project_0x701_ECU1_Msg_TP1
        CanIfBufferCfg_OUT_ECU1_Project_0x602_ECU1_Msg_P4: CanIfBufferHthRef=CanIfHthCfg_OUT_ECU1_Project_0x602_ECU1_Msg_P4
        CanIfBufferCfg_OUT_ECU1_Project_0x601_ECU1_Msg_P3: CanIfBufferHthRef=CanIfHthCfg_OUT_ECU1_Project_0x601_ECU1_Msg_P3
        CanIfBufferCfg_OUT_ECU1_Project_0x502_ECU1_Msg_P2: CanIfBufferHthRef=CanIfHthCfg_OUT_ECU1_Project_0x502_ECU1_Msg_P2
        CanIfBufferCfg_OUT_ECU1_Project_0x501_ECU1_Msg_P1: CanIfBufferHthRef=CanIfHthCfg_OUT_ECU1_Project_0x501_ECU1_Msg_P1
        CanIfBufferCfg_OUT_ECU1_Project_0x300_ECU1_Msg_PIF1: CanIfBufferHthRef=CanIfHthCfg_OUT_ECU1_Project_0x300_ECU1_Msg_PIF1
        CanIfBufferCfg_OUT_ECU1_Project_0x200_ECU1_Msg_IF1: CanIfBufferHthRef=CanIfHthCfg_OUT_ECU1_Project_0x200_ECU1_Msg_IF1
        CanIfBufferCfg_OUT_ECU1_Project_0x102_ECU1_Msg_POE2: CanIfBufferHthRef=CanIfHthCfg_OUT_ECU1_Project_0x102_ECU1_Msg_POE2
        CanIfBufferCfg_OUT_ECU1_Project_0x101_ECU1_Msg_POE1: CanIfBufferHthRef=CanIfHthCfg_OUT_ECU1_Project_0x101_ECU1_Msg_POE1
        CanIfBufferCfg_OUT_ECU1_Project_0x100_ECU1_Msg_POE3: CanIfBufferHthRef=CanIfHthCfg_OUT_ECU1_Project_0x100_ECU1_Msg_POE3
        CanIfBufferCfg_OUT_ECU1_Project_0x55_ECU1_Msg_GW1: CanIfBufferHthRef=CanIfHthCfg_OUT_ECU1_Project_0x55_ECU1_Msg_GW1
        CanIfBufferCfg_OUT_ECU1_Project_0x2_ECU1_Msg_OE2: CanIfBufferHthRef=CanIfHthCfg_OUT_ECU1_Project_0x2_ECU1_Msg_OE2
        CanIfBufferCfg_OUT_ECU1_Project_0x1_ECU1_Msg_OE1: CanIfBufferHthRef=CanIfHthCfg_OUT_ECU1_Project_0x1_ECU1_Msg_OE1
      CanIfInitHohCfg: category=TOOL_CONFIGURED, CanIfInitRefCfgSet=CanConfigSet
        8 x CanIfHrhCfg, all with category=TOOL_CONFIGURED, CanIfHrhSoftwareFilter=1, CanIfHrhCanCtrlIdRef=CanIfCtrlCfg_ECU1_Project:
          CanIfHrhCfg_IN_ECU1_Project_0x7df_GST_Msg_TP_Func: CanIfHrhCanHandleTypeRef=IN_HwObj_ECU1_Project_0x7df_GST_Msg_TP_Func, CanIfHrhIdSymRef=IN_HwObj_ECU1_Project_0x7df_GST_Msg_TP_Func
          CanIfHrhCfg_IN_ECU1_Project_0x707_GST_Msg_TP2: CanIfHrhCanHandleTypeRef=IN_HwObj_ECU1_Project_0x707_GST_Msg_TP2, CanIfHrhIdSymRef=IN_HwObj_ECU1_Project_0x707_GST_Msg_TP2
          CanIfHrhCfg_IN_ECU1_Project_0x706_GST_Msg_TP1: CanIfHrhCanHandleTypeRef=IN_HwObj_ECU1_Project_0x706_GST_Msg_TP1, CanIfHrhIdSymRef=IN_HwObj_ECU1_Project_0x706_GST_Msg_TP1
          CanIfHrhCfg_IN_ECU1_Project_0x703_GST_Msg_TP_Phys: CanIfHrhCanHandleTypeRef=IN_HwObj_ECU1_Project_0x703_GST_Msg_TP_Phys, CanIfHrhIdSymRef=IN_HwObj_ECU1_Project_0x703_GST_Msg_TP_Phys
          CanIfHrhCfg_IN_ECU1_Project_0x503_ECU2_Msg_P1: CanIfHrhCanHandleTypeRef=IN_HwObj_ECU1_Project_0x503_ECU2_Msg_P1, CanIfHrhIdSymRef=IN_HwObj_ECU1_Project_0x503_ECU2_Msg_P1
          CanIfHrhCfg_IN_ECU1_Project_0x301_ECU2_Msg_PIF1: CanIfHrhCanHandleTypeRef=IN_HwObj_ECU1_Project_0x301_ECU2_Msg_PIF1, CanIfHrhIdSymRef=IN_HwObj_ECU1_Project_0x301_ECU2_Msg_PIF1
          CanIfHrhCfg_IN_ECU1_Project_0x103_ECU2_Msg_POE1: CanIfHrhCanHandleTypeRef=IN_HwObj_ECU1_Project_0x103_ECU2_Msg_POE1, CanIfHrhIdSymRef=IN_HwObj_ECU1_Project_0x103_ECU2_Msg_POE1
          CanIfHrhCfg_IN_ECU1_Project_0x3_ECU2_Msg_OE1: CanIfHrhCanHandleTypeRef=IN_HwObj_ECU1_Project_0x3_ECU2_Msg_OE1, CanIfHrhIdSymRef=IN_HwObj_ECU1_Project_0x3_ECU2_Msg_OE1
        15 x CanIfHthCfg, all with category=TOOL_CONFIGURED, CanIfHthCanCtrlIdRef=CanIfCtrlCfg_ECU1_Project:
          CanIfHthCfg_OUT_ECU1_Project_0x705_ECU1_GST_Msg_TP: CanIfHthCanHandleTypeRef=OUT_HwObj_ECU1_Project_0x705_ECU1_GST_Msg_TP, CanIfHthIdSymRef=OUT_HwObj_ECU1_Project_0x705_ECU1_GST_Msg_TP
          CanIfHthCfg_OUT_ECU1_Project_0x704_ECU1_Msg_TP2: CanIfHthCanHandleTypeRef=OUT_HwObj_ECU1_Project_0x704_ECU1_Msg_TP2, CanIfHthIdSymRef=OUT_HwObj_ECU1_Project_0x704_ECU1_Msg_TP2
          CanIfHthCfg_OUT_ECU1_Project_0x701_ECU1_Msg_TP1: CanIfHthCanHandleTypeRef=OUT_HwObj_ECU1_Project_0x701_ECU1_Msg_TP1, CanIfHthIdSymRef=OUT_HwObj_ECU1_Project_0x701_ECU1_Msg_TP1
          CanIfHthCfg_OUT_ECU1_Project_0x602_ECU1_Msg_P4: CanIfHthCanHandleTypeRef=OUT_HwObj_ECU1_Project_0x602_ECU1_Msg_P4, CanIfHthIdSymRef=OUT_HwObj_ECU1_Project_0x602_ECU1_Msg_P4
          CanIfHthCfg_OUT_ECU1_Project_0x601_ECU1_Msg_P3: CanIfHthCanHandleTypeRef=OUT_HwObj_ECU1_Project_0x601_ECU1_Msg_P3, CanIfHthIdSymRef=OUT_HwObj_ECU1_Project_0x601_ECU1_Msg_P3
          CanIfHthCfg_OUT_ECU1_Project_0x502_ECU1_Msg_P2: CanIfHthCanHandleTypeRef=OUT_HwObj_ECU1_Project_0x502_ECU1_Msg_P2, CanIfHthIdSymRef=OUT_HwObj_ECU1_Project_0x502_ECU1_Msg_P2
          CanIfHthCfg_OUT_ECU1_Project_0x501_ECU1_Msg_P1: CanIfHthCanHandleTypeRef=OUT_HwObj_ECU1_Project_0x501_ECU1_Msg_P1, CanIfHthIdSymRef=OUT_HwObj_ECU1_Project_0x501_ECU1_Msg_P1
          CanIfHthCfg_OUT_ECU1_Project_0x300_ECU1_Msg_PIF1: CanIfHthCanHandleTypeRef=OUT_HwObj_ECU1_Project_0x300_ECU1_Msg_PIF1, CanIfHthIdSymRef=OUT_HwObj_ECU1_Project_0x300_ECU1_Msg_PIF1
          CanIfHthCfg_OUT_ECU1_Project_0x200_ECU1_Msg_IF1: CanIfHthCanHandleTypeRef=OUT_HwObj_ECU1_Project_0x200_ECU1_Msg_IF1, CanIfHthIdSymRef=OUT_HwObj_ECU1_Project_0x200_ECU1_Msg_IF1
          CanIfHthCfg_OUT_ECU1_Project_0x102_ECU1_Msg_POE2: CanIfHthCanHandleTypeRef=OUT_HwObj_ECU1_Project_0x102_ECU1_Msg_POE2, CanIfHthIdSymRef=OUT_HwObj_ECU1_Project_0x102_ECU1_Msg_POE2
          CanIfHthCfg_OUT_ECU1_Project_0x101_ECU1_Msg_POE1: CanIfHthCanHandleTypeRef=OUT_HwObj_ECU1_Project_0x101_ECU1_Msg_POE1, CanIfHthIdSymRef=OUT_HwObj_ECU1_Project_0x101_ECU1_Msg_POE1
          CanIfHthCfg_OUT_ECU1_Project_0x100_ECU1_Msg_POE3: CanIfHthCanHandleTypeRef=OUT_HwObj_ECU1_Project_0x100_ECU1_Msg_POE3, CanIfHthIdSymRef=OUT_HwObj_ECU1_Project_0x100_ECU1_Msg_POE3
          CanIfHthCfg_OUT_ECU1_Project_0x55_ECU1_Msg_GW1: CanIfHthCanHandleTypeRef=OUT_HwObj_ECU1_Project_0x55_ECU1_Msg_GW1, CanIfHthIdSymRef=OUT_HwObj_ECU1_Project_0x55_ECU1_Msg_GW1
          CanIfHthCfg_OUT_ECU1_Project_0x2_ECU1_Msg_OE2: CanIfHthCanHandleTypeRef=OUT_HwObj_ECU1_Project_0x2_ECU1_Msg_OE2, CanIfHthIdSymRef=OUT_HwObj_ECU1_Project_0x2_ECU1_Msg_OE2
          CanIfHthCfg_OUT_ECU1_Project_0x1_ECU1_Msg_OE1: CanIfHthCanHandleTypeRef=OUT_HwObj_ECU1_Project_0x1_ECU1_Msg_OE1, CanIfHthIdSymRef=OUT_HwObj_ECU1_Project_0x1_ECU1_Msg_OE1
        3 x CanIfHrhCfg, all with category=TOOL_CONFIGURED, CanIfHrhSoftwareFilter=true, CanIfHrhCanCtrlIdRef=CanIfCtrlCfg_ECU1_Project:
          CanIfHrhCfg_IN_ECU1_Project_0x7fd_CC_Recv2: CanIfHrhCanHandleTypeRef=IN_HwObj_ECU1_Project_0x7fd_CC_Recv2, CanIfHrhIdSymRef=IN_HwObj_ECU1_Project_0x7fd_CC_Recv2
          CanIfHrhCfg_IN_ECU1_Project_0x7fc_LKAS_Recv: CanIfHrhCanHandleTypeRef=IN_HwObj_ECU1_Project_0x7fc_LKAS_Recv, CanIfHrhIdSymRef=IN_HwObj_ECU1_Project_0x7fc_LKAS_Recv
          CanIfHrhCfg_IN_ECU1_Project_0x7ef_CC_Recv1: CanIfHrhCanHandleTypeRef=IN_HwObj_ECU1_Project_0x7ef_CC_Recv1, CanIfHrhIdSymRef=IN_HwObj_ECU1_Project_0x7ef_CC_Recv1
        CanIfHthCfg_OUT_ECU1_Project_0x7ff_CC_Send (CanIfHthCfg):
          category = TOOL_CONFIGURED
          CanIfHthCanCtrlIdRef = CanIfCtrlCfg_ECU1_Project
          CanIfHthCanHandleTypeRef = OUT_HwObj_ECU1_Project_0x7ff_CC_Send
          CanIfHthIdSymRef = OUT_HwObj_ECU1_Project_0x7ff_CC_Send
        CanIfHthCfg_OUT_ECU1_Project_0x7fe_LKAS_Send (CanIfHthCfg):
          category = TOOL_CONFIGURED
          CanIfHthCanCtrlIdRef = CanIfCtrlCfg_ECU1_Project
          CanIfHthCanHandleTypeRef = OUT_HwObj_ECU1_Project_0x7fe_LKAS_Send
          CanIfHthIdSymRef = OUT_HwObj_ECU1_Project_0x7fe_LKAS_Send
      8 x CanIfRxPduCfg, all with category=TOOL_CONFIGURED, CanIfRxPduCanIdType=STANDARD_CAN, CanIfRxPduReadData=0, CanIfRxPduReadNotifyStatus=0, CanIfRxPduCanIdMask=(unset), CanIfPduReportIdsMEnable=0:
        CanIfRxPduCfg_IN_ECU1_Project_0x7df_GST_Msg_TP_Func: CanIfRxPduCanId=2015, CanIfRxPduDlc=8, CanIfRxPduId=0, CanIfRxPduUserRxIndicationUL=CAN_TP, CanIfRxPduHrhIdRef=CanIfHrhCfg_IN_ECU1_Project_0x7df_GST_Msg_TP_Func, CanIfRxPduRef=Pdu_NPdu_GST_Msg_TP_Func
        CanIfRxPduCfg_IN_ECU1_Project_0x707_GST_Msg_TP2: CanIfRxPduCanId=1799, CanIfRxPduDlc=8, CanIfRxPduId=1, CanIfRxPduUserRxIndicationUL=CAN_TP, CanIfRxPduHrhIdRef=CanIfHrhCfg_IN_ECU1_Project_0x707_GST_Msg_TP2, CanIfRxPduRef=Pdu_NPdu_GST_Msg_TP2
        CanIfRxPduCfg_IN_ECU1_Project_0x706_GST_Msg_TP1: CanIfRxPduCanId=1798, CanIfRxPduDlc=8, CanIfRxPduId=2, CanIfRxPduUserRxIndicationUL=CAN_TP, CanIfRxPduHrhIdRef=CanIfHrhCfg_IN_ECU1_Project_0x706_GST_Msg_TP1, CanIfRxPduRef=Pdu_NPdu_GST_Msg_TP1
        CanIfRxPduCfg_IN_ECU1_Project_0x703_GST_Msg_TP_Phys: CanIfRxPduCanId=1795, CanIfRxPduDlc=8, CanIfRxPduId=3, CanIfRxPduUserRxIndicationUL=CAN_TP, CanIfRxPduHrhIdRef=CanIfHrhCfg_IN_ECU1_Project_0x703_GST_Msg_TP_Phys, CanIfRxPduRef=Pdu_NPdu_GST_Msg_TP_Phys
        CanIfRxPduCfg_IN_ECU1_Project_0x503_ECU2_Msg_P1: CanIfRxPduCanId=1283, CanIfRxPduDlc=2, CanIfRxPduId=4, CanIfRxPduUserRxIndicationUL=PDUR, CanIfRxPduHrhIdRef=CanIfHrhCfg_IN_ECU1_Project_0x503_ECU2_Msg_P1, CanIfRxPduRef=Pdu_ISignalIPdu_ECU2_Msg_P1
        CanIfRxPduCfg_IN_ECU1_Project_0x301_ECU2_Msg_PIF1: CanIfRxPduCanId=769, CanIfRxPduDlc=8, CanIfRxPduId=5, CanIfRxPduUserRxIndicationUL=PDUR, CanIfRxPduHrhIdRef=CanIfHrhCfg_IN_ECU1_Project_0x301_ECU2_Msg_PIF1, CanIfRxPduRef=Pdu_ISignalIPdu_ECU2_Msg_PIF1
        CanIfRxPduCfg_IN_ECU1_Project_0x103_ECU2_Msg_POE1: CanIfRxPduCanId=259, CanIfRxPduDlc=8, CanIfRxPduId=6, CanIfRxPduUserRxIndicationUL=PDUR, CanIfRxPduHrhIdRef=CanIfHrhCfg_IN_ECU1_Project_0x103_ECU2_Msg_POE1, CanIfRxPduRef=Pdu_ISignalIPdu_ECU2_Msg_POE1
        CanIfRxPduCfg_IN_ECU1_Project_0x3_ECU2_Msg_OE1: CanIfRxPduCanId=3, CanIfRxPduDlc=8, CanIfRxPduId=7, CanIfRxPduUserRxIndicationUL=PDUR, CanIfRxPduHrhIdRef=CanIfHrhCfg_IN_ECU1_Project_0x3_ECU2_Msg_OE1, CanIfRxPduRef=Pdu_ISignalIPdu_ECU2_Msg_OE1
      15 x CanIfTxPduCfg, all with category=TOOL_CONFIGURED, CanIfTxPduCanIdType=STANDARD_CAN, CanIfTxPduDlc=8, CanIfTxPduReadNotifyStatus=0, CanIfTxPduType=STATIC, CanIfTxPduCanIdMask=(unset):
        CanIfTxPduCfg_OUT_ECU1_Project_0x705_ECU1_GST_Msg_TP: CanIfTxPduCanId=1797, CanIfTxPduId=12, CanIfTxPduUserTxConfirmationUL=CAN_TP, CanIfTxPduBufferRef=CanIfBufferCfg_OUT_ECU1_Project_0x701_ECU1_Msg_TP1, CanIfTxPduRef=Pdu_NPdu_ECU1_GST_Msg_TP
        CanIfTxPduCfg_OUT_ECU1_Project_0x55_ECU1_Msg_GW1: CanIfTxPduCanId=85, CanIfTxPduId=3, CanIfTxPduUserTxConfirmationUL=PDUR, CanIfTxPduBufferRef=CanIfBufferCfg_OUT_ECU1_Project_0x1_ECU1_Msg_OE1, CanIfTxPduRef=Pdu_ISignalIPdu_ECU1_Msg_GW1
        CanIfTxPduCfg_OUT_ECU1_Project_0x704_ECU1_Msg_TP2: CanIfTxPduCanId=1796, CanIfTxPduId=11, CanIfTxPduUserTxConfirmationUL=CAN_TP, CanIfTxPduBufferRef=CanIfBufferCfg_OUT_ECU1_Project_0x602_ECU1_Msg_P4, CanIfTxPduRef=Pdu_NPdu_ECU1_Msg_TP2
        CanIfTxPduCfg_OUT_ECU1_Project_0x200_ECU1_Msg_IF1: CanIfTxPduCanId=512, CanIfTxPduId=1, CanIfTxPduUserTxConfirmationUL=PDUR, CanIfTxPduBufferRef=CanIfBufferCfg_OUT_ECU1_Project_0x101_ECU1_Msg_POE1, CanIfTxPduRef=Pdu_ISignalIPdu_ECU1_Msg_IF1
        CanIfTxPduCfg_OUT_ECU1_Project_0x100_ECU1_Msg_POE3: CanIfTxPduCanId=256, CanIfTxPduId=5, CanIfTxPduUserTxConfirmationUL=PDUR, CanIfTxPduBufferRef=CanIfBufferCfg_OUT_ECU1_Project_0x2_ECU1_Msg_OE2, CanIfTxPduRef=Pdu_ISignalIPdu_ECU1_Msg_POE3
        CanIfTxPduCfg_OUT_ECU1_Project_0x701_ECU1_Msg_TP1: CanIfTxPduCanId=1793, CanIfTxPduId=10, CanIfTxPduUserTxConfirmationUL=CAN_TP, CanIfTxPduBufferRef=CanIfBufferCfg_OUT_ECU1_Project_0x601_ECU1_Msg_P3, CanIfTxPduRef=Pdu_NPdu_ECU1_Msg_TP1
        CanIfTxPduCfg_OUT_ECU1_Project_0x602_ECU1_Msg_P4: CanIfTxPduCanId=1538, CanIfTxPduId=8, CanIfTxPduUserTxConfirmationUL=PDUR, CanIfTxPduBufferRef=CanIfBufferCfg_OUT_ECU1_Project_0x502_ECU1_Msg_P2, CanIfTxPduRef=Pdu_ISignalIPdu_ECU1_Msg_P4
        CanIfTxPduCfg_OUT_ECU1_Project_0x601_ECU1_Msg_P3: CanIfTxPduCanId=1537, CanIfTxPduId=7, CanIfTxPduUserTxConfirmationUL=PDUR, CanIfTxPduBufferRef=CanIfBufferCfg_OUT_ECU1_Project_0x501_ECU1_Msg_P1, CanIfTxPduRef=Pdu_ISignalIPdu_ECU1_Msg_P3
        CanIfTxPduCfg_OUT_ECU1_Project_0x300_ECU1_Msg_PIF1: CanIfTxPduCanId=768, CanIfTxPduId=2, CanIfTxPduUserTxConfirmationUL=PDUR, CanIfTxPduBufferRef=CanIfBufferCfg_OUT_ECU1_Project_0x102_ECU1_Msg_POE2, CanIfTxPduRef=Pdu_ISignalIPdu_ECU1_Msg_PIF1
        CanIfTxPduCfg_OUT_ECU1_Project_0x502_ECU1_Msg_P2: CanIfTxPduCanId=1282, CanIfTxPduId=6, CanIfTxPduUserTxConfirmationUL=PDUR, CanIfTxPduBufferRef=CanIfBufferCfg_OUT_ECU1_Project_0x300_ECU1_Msg_PIF1, CanIfTxPduRef=Pdu_ISignalIPdu_ECU1_Msg_P2
        CanIfTxPduCfg_OUT_ECU1_Project_0x501_ECU1_Msg_P1: CanIfTxPduCanId=1281, CanIfTxPduId=4, CanIfTxPduUserTxConfirmationUL=PDUR, CanIfTxPduBufferRef=CanIfBufferCfg_OUT_ECU1_Project_0x200_ECU1_Msg_IF1, CanIfTxPduRef=Pdu_ISignalIPdu_ECU1_Msg_P1
        CanIfTxPduCfg_OUT_ECU1_Project_0x102_ECU1_Msg_POE2: CanIfTxPduCanId=258, CanIfTxPduId=0, CanIfTxPduUserTxConfirmationUL=PDUR, CanIfTxPduBufferRef=CanIfBufferCfg_OUT_ECU1_Project_0x100_ECU1_Msg_POE3, CanIfTxPduRef=Pdu_ISignalIPdu_ECU1_Msg_POE2
        CanIfTxPduCfg_OUT_ECU1_Project_0x101_ECU1_Msg_POE1: CanIfTxPduCanId=257, CanIfTxPduId=9, CanIfTxPduUserTxConfirmationUL=PDUR, CanIfTxPduBufferRef=CanIfBufferCfg_OUT_ECU1_Project_0x55_ECU1_Msg_GW1, CanIfTxPduRef=Pdu_ISignalIPdu_ECU1_Msg_POE1
        CanIfTxPduCfg_OUT_ECU1_Project_0x2_ECU1_Msg_OE2: CanIfTxPduCanId=2, CanIfTxPduId=16, CanIfTxPduUserTxConfirmationUL=PDUR, CanIfTxPduBufferRef=CanIfBufferCfg_OUT_ECU1_Project_0x7ff_CC_Send, CanIfTxPduRef=Pdu_ISignalIPdu_ECU1_Msg_OE2
        CanIfTxPduCfg_OUT_ECU1_Project_0x1_ECU1_Msg_OE1: CanIfTxPduCanId=1, CanIfTxPduId=15, CanIfTxPduUserTxConfirmationUL=PDUR, CanIfTxPduBufferRef=CanIfBufferCfg_OUT_ECU1_Project_0x7fe_LKAS_Send, CanIfTxPduRef=Pdu_ISignalIPdu_ECU1_Msg_OE1
      3 x CanIfRxPduCfg, all with category=TOOL_CONFIGURED, CanIfRxPduCanIdType=STANDARD_CAN, CanIfRxPduDlc=8, CanIfPduReportIdsMEnable=0, CanIfRxPduUserRxIndicationUL=PDUR, CanIfRxPduReadData=false, CanIfRxPduReadNotifyStatus=false, CanIfRxPduCanIdMask=(unset):
        CanIfRxPduCfg_IN_ECU1_Project_0x7fd_CC_Recv2: CanIfRxPduCanId=2045, CanIfRxPduId=8, CanIfRxPduHrhIdRef=CanIfHrhCfg_IN_ECU1_Project_0x7fd_CC_Recv2, CanIfRxPduRef=Pdu_ISignalIPdu_CC_Recv2
        CanIfRxPduCfg_IN_ECU1_Project_0x7fc_LKAS_Recv: CanIfRxPduCanId=2044, CanIfRxPduId=9, CanIfRxPduHrhIdRef=CanIfHrhCfg_IN_ECU1_Project_0x7fc_LKAS_Recv, CanIfRxPduRef=Pdu_ISignalIPdu_LKAS_Recv
        CanIfRxPduCfg_IN_ECU1_Project_0x7ef_CC_Recv1: CanIfRxPduCanId=2031, CanIfRxPduId=10, CanIfRxPduHrhIdRef=CanIfHrhCfg_IN_ECU1_Project_0x7ef_CC_Recv1, CanIfRxPduRef=Pdu_ISignalIPdu_CC_Recv1
      CanIfBufferCfg_OUT_ECU1_Project_0x7ff_CC_Send (CanIfBufferCfg): category=TOOL_CONFIGURED, CanIfBufferSize=0, CanIfBufferHthRef=CanIfHthCfg_OUT_ECU1_Project_0x7ff_CC_Send
      CanIfBufferCfg_OUT_ECU1_Project_0x7fe_LKAS_Send (CanIfBufferCfg): category=TOOL_CONFIGURED, CanIfBufferSize=0, CanIfBufferHthRef=CanIfHthCfg_OUT_ECU1_Project_0x7fe_LKAS_Send
      CanIfTxPduCfg_OUT_ECU1_Project_0x7ff_CC_Send (CanIfTxPduCfg):
        category = TOOL_CONFIGURED
        CanIfTxPduCanId = 2047
        CanIfTxPduCanIdType = STANDARD_CAN
        CanIfTxPduId = 14
        CanIfTxPduDlc = 8
        CanIfTxPduUserTxConfirmationUL = PDUR
        CanIfTxPduReadNotifyStatus = false
        CanIfTxPduType = STATIC
        CanIfTxPduCanIdMask = (unset)
        CanIfTxPduBufferRef = CanIfBufferCfg_OUT_ECU1_Project_0x705_ECU1_GST_Msg_TP
        CanIfTxPduRef = Pdu_ISignalIPdu_CC_Send
      CanIfTxPduCfg_OUT_ECU1_Project_0x7fe_LKAS_Send (CanIfTxPduCfg):
        category = TOOL_CONFIGURED
        CanIfTxPduCanId = 2046
        CanIfTxPduCanIdType = STANDARD_CAN
        CanIfTxPduId = 13
        CanIfTxPduDlc = 8
        CanIfTxPduUserTxConfirmationUL = PDUR
        CanIfTxPduReadNotifyStatus = false
        CanIfTxPduType = STATIC
        CanIfTxPduCanIdMask = (unset)
        CanIfTxPduBufferRef = CanIfBufferCfg_OUT_ECU1_Project_0x704_ECU1_Msg_TP2
        CanIfTxPduRef = Pdu_ISignalIPdu_LKAS_Send
    CanIfPrivateCfg: CanIfPrivateDlcCheck=1, CanIfPrivateSoftwareFilterType=BINARY, CanIfSupportTTCAN=0, CanIfSupportCANFD=0, CanIfSupportCanCM=0
    CanIfPublicCfg:
      CanIfPublicCancelTransmitSupport = 0
      CanIfPublicChangeBaudrateSupport = 0
      CanIfPublicDevErrorDetect = 1
      CanIfPublicMultipleDrvSupport = 0
      CanIfPublicNumberOfCanHwUnits = 1
      CanIfPublicPnSupport = 0
      CanIfPublicReadRxPduDataApi = 0
      CanIfPublicReadRxPduNotifyStatusApi = 0
      CanIfPublicReadTxPduNotifyStatusApi = 0
      CanIfPublicSetDynamicTxIdApi = 0
      CanIfPublicTxBuffering = 1
      CanIfPublicTxConfirmPollingSupport = 0
      CanIfPublicVersionInfoApi = 0
      CanIfPublicWakeupCheckValidByNM = 0
      CanIfPublicWakeupCheckValidSupport = 0
      CanIfMetaDataSupport = 0
      CanIfPublicHandleTypeEnum = UINT16
      CanIfAutronTrcvDrvSupport = 0
      CanIfExternalTrcvDrvSupport = 0
      CanIfCANFDID16BitSupport = 0
      CanIfCANFDDiscreteDlcSupport = 0
