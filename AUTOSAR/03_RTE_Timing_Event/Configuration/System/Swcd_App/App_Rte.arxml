AUTOSAR XML (schema 4-3-0)
package /App_Rte
  application sw component type SWC_SeatSwitch
    behavior InternalBehavior
      timing event TE_RE_SeatSwitch: start-on-event=RE_SeatSwitch, period=0.1
      runnable RE_SeatSwitch: symbol=SeatSwitch
  composition sw component type CSWC_SeatSystem
    component SWC_SeatSwitch: type=SWC_SeatSwitch
